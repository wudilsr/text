## kernel/drivers/power/Kconfig
```kconfig
source "drivers/power/avs/Kconfig"
source "drivers/power/reset/Kconfig"
source "drivers/power/supply/Kconfig"
source "drivers/power/qcom/Kconfig"
source "drivers/power/huawei/Kconfig"
source "drivers/power/hw_kstate/Kconfig"
source "drivers/power/dubai/Kconfig"
source "drivers/power/usb_short_circuit_protect/Kconfig"
config HUAWEI_SLEEPLOG
     bool "huawei sleeplog"
     default n
     help
```

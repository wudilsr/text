
/ {
    huawei_audio_info {
        compatible = "hw,hw_audio_info";
        product-identifier = "bangkok";
        builtin-master-mic-exist;
        builtin-second-mic-exist;
        hand_held_dual_mic_strategy;
        loud_speaker_second_mic_strategy;
        cust_name = "audio_custom_v2";
        voice-vol-level = <10>;
        status = "ok";
    };
};

&int_codec {
    status = "okay";
    qcom,msm-micbias1-ext-cap;
    qcom,msm-mbhc-hphl-swh = <1>;
    qcom,msm-mbhc-gnd-swh = <1>;
    qcom,msm-hs-micbias-type = "internal";
    qcom,audio-routing =
        "RX_BIAS", "MCLK",
        "SPK_RX_BIAS", "MCLK",
        "INT_LDO_H", "MCLK",
        "RX_I2S_CLK", "MCLK",
        "TX_I2S_CLK", "MCLK",
        "MIC BIAS External", "Handset Mic",
        "MIC BIAS Internal2", "Headset Mic",
        "MIC BIAS External", "Secondary Mic",
        "AMIC1", "MIC BIAS External",
        "AMIC2", "MIC BIAS Internal2",
        "AMIC3", "MIC BIAS External",
        "ADC1_IN", "ADC1_OUT",
        "ADC2_IN", "ADC2_OUT",
        "ADC3_IN", "ADC3_OUT",
        "PDM_IN_RX1", "PDM_OUT_RX1",
        "PDM_IN_RX2", "PDM_OUT_RX2",
        "PDM_IN_RX3", "PDM_OUT_RX3",
        "WSA_SPK OUT", "VDD_WSA_SWITCH",
        "SpkrMono WSA_IN", "WSA_SPK OUT";
};

&pmic_analog_codec {
    qcom,cdc-boost-voltage = <5300>;
};

/*---------------------------------------------------------------------------
 * This file is autogenerated file using huawei LCD parser. Please do not edit it.
 * Update input XML file to add a new entry or update variable in this file
 * Parser location: vendor/huawei/chipset_common/devkit/lcdkit/tools 
 *---------------------------------------------------------------------------*/


#include "bkk_al10bhn_vb_hlt_boe_ft8006s_6p26_720p_video.dtsi"
#include "bkk_al10bhn_vb_hlt_boe_ili9881h_6p26_720p_video.dtsi"
#include "bkk_al10bhn_vb_ofilm_csot_hx83112a_6p26_720p_video.dtsi"
#include "bkk_al10bhn_vb_txd_inx_nt36525_6p26_720p_video.dtsi"
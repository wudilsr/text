/* Copyright (c) 2013, The Linux Foundation. All rights reserved.
 *
 * This program is free software; you can redistribute it and/or modify
 * it under the terms of the GNU General Public License version 2 and
 * only version 2 as published by the Free Software Foundation.
 *
 * This program is distributed in the hope that it will be useful,
 * but WITHOUT ANY WARRANTY; without even the implied warranty of
 * MERCHANTABILITY or FITNESS FOR A PARTICULAR PURPOSE.  See the
 * GNU General Public License for more details.
 */

/*-------------------------------------------------------------------------
 * This file is autogenerated file using gcdb parser. Please do not edit it.
 * Update input XML file to add a new entry or update variable in this file
 * VERSION = 1.1
 *-----------------------------------------------------------------------*/
/ {
	dsi_dub_l03_va_txd_inx_ili7807d_6p26_720p_video: lcdkit_dub_l03_va_txd_inx_ili7807d_6p26_720p_video {
		compatible = "txd-inx-ili7807d-6p26-720p-video";
		hw,lcdkit-panel-name = "TXD_INX_ILI7807D 6P26 VIDEO TFT 720 x 1520";
		hw,lcdkit-panel-type = <0x01>;
		hw,lcdkit-panel-xres = <720>;
		hw,lcdkit-panel-yres = <1520>;
		hw,lcdkit-panel-width = <68>;
		hw,lcdkit-panel-height = <144>;
		hw,lcdkit-panel-on-command = [39 01 00 00 00 00 04 FF 78 07 01
		39 01 00 00 00 00 02 0A 02
		39 01 00 00 00 00 02 30 09
		39 01 00 00 00 00 02 42 11
		39 01 00 00 00 00 02 43 94
		39 01 00 00 00 00 02 44 9E
		39 01 00 00 00 00 02 48 22
		39 01 00 00 00 00 02 49 22
		39 01 00 00 00 00 02 4A 05
		39 01 00 00 00 00 02 4B 05
		39 01 00 00 00 00 02 50 5A
		39 01 00 00 00 00 02 51 5A
		39 01 00 00 00 00 02 52 00
		39 01 00 00 00 00 02 53 00
		39 01 00 00 00 00 02 5A 33
		39 01 00 00 00 00 02 B3 60
		39 01 00 00 00 00 02 B4 60
		39 01 00 00 00 00 02 A2 01
		39 01 00 00 00 00 02 A3 0A
		39 01 00 00 00 00 02 22 06
		39 01 00 00 00 00 02 35 22
		39 01 00 00 00 00 02 36 00
		39 01 00 00 00 00 02 63 0B
		39 01 00 00 00 00 02 64 08
		39 01 00 00 00 00 02 65 00
		39 01 00 00 00 00 02 66 04
		39 01 00 00 00 00 02 6C 45
		39 01 00 00 00 00 02 6D 00
		39 01 00 00 00 00 02 2E F7
		39 01 00 00 00 00 02 2F 02
		39 01 00 00 00 00 04 FF 78 07 06
		39 01 00 00 00 00 02 00 40
		39 01 00 00 00 00 02 01 00
		39 01 00 00 00 00 02 02 00
		39 01 00 00 00 00 02 03 0A
		39 01 00 00 00 00 02 04 00
		39 01 00 00 00 00 02 05 00
		39 01 00 00 00 00 02 06 00
		39 01 00 00 00 00 02 07 00
		39 01 00 00 00 00 02 08 01
		39 01 00 00 00 00 02 09 04
		39 01 00 00 00 00 02 0a 30
		39 01 00 00 00 00 02 0b 00
		39 01 00 00 00 00 02 0c 00
		39 01 00 00 00 00 02 0d 00
		39 01 00 00 00 00 02 0e 0A
		39 01 00 00 00 00 02 0f 0A
		39 01 00 00 00 00 02 10 00
		39 01 00 00 00 00 02 11 00
		39 01 00 00 00 00 02 12 00
		39 01 00 00 00 00 02 13 00
		39 01 00 00 00 00 02 14 83
		39 01 00 00 00 00 02 15 83
		39 01 00 00 00 00 02 16 00
		39 01 00 00 00 00 02 17 00
		39 01 00 00 00 00 02 18 00
		39 01 00 00 00 00 02 19 00
		39 01 00 00 00 00 02 1a 00
		39 01 00 00 00 00 02 1b 00
		39 01 00 00 00 00 02 1c 00
		39 01 00 00 00 00 02 1d 00
		39 01 00 00 00 00 02 1e 00
		39 01 00 00 00 00 02 1f 00
		39 01 00 00 00 00 02 20 00
		39 01 00 00 00 00 02 21 00
		39 01 00 00 00 00 02 22 00
		39 01 00 00 00 00 02 23 00
		39 01 00 00 00 00 02 24 00
		39 01 00 00 00 00 02 25 00
		39 01 00 00 00 00 02 26 00
		39 01 00 00 00 00 02 27 00
		39 01 00 00 00 00 02 28 00
		39 01 00 00 00 00 02 29 00
		39 01 00 00 00 00 02 2a 00
		39 01 00 00 00 00 02 2b 00
		39 01 00 00 00 00 02 2c 00
		39 01 00 00 00 00 02 2d 00
		39 01 00 00 00 00 02 2e 00
		39 01 00 00 00 00 02 2f 00
		39 01 00 00 00 00 02 31 02
		39 01 00 00 00 00 02 32 2A
		39 01 00 00 00 00 02 33 29
		39 01 00 00 00 00 02 34 28
		39 01 00 00 00 00 02 35 22
		39 01 00 00 00 00 02 36 23
		39 01 00 00 00 00 02 37 13
		39 01 00 00 00 00 02 38 12
		39 01 00 00 00 00 02 39 11
		39 01 00 00 00 00 02 3a 10
		39 01 00 00 00 00 02 3b 08
		39 01 00 00 00 00 02 3c 07
		39 01 00 00 00 00 02 3d 07
		39 01 00 00 00 00 02 3e 07
		39 01 00 00 00 00 02 3f 07
		39 01 00 00 00 00 02 40 07
		39 01 00 00 00 00 02 41 02
		39 01 00 00 00 00 02 42 2A
		39 01 00 00 00 00 02 43 29
		39 01 00 00 00 00 02 44 28
		39 01 00 00 00 00 02 45 22
		39 01 00 00 00 00 02 46 23
		39 01 00 00 00 00 02 47 13
		39 01 00 00 00 00 02 48 12
		39 01 00 00 00 00 02 49 11
		39 01 00 00 00 00 02 4a 10
		39 01 00 00 00 00 02 4b 08
		39 01 00 00 00 00 02 4c 07
		39 01 00 00 00 00 02 4d 07
		39 01 00 00 00 00 02 4e 07
		39 01 00 00 00 00 02 4f 07
		39 01 00 00 00 00 02 50 07
		39 01 00 00 00 00 02 61 02
		39 01 00 00 00 00 02 62 2A
		39 01 00 00 00 00 02 63 29
		39 01 00 00 00 00 02 64 28
		39 01 00 00 00 00 02 65 22
		39 01 00 00 00 00 02 66 23
		39 01 00 00 00 00 02 67 10
		39 01 00 00 00 00 02 68 11
		39 01 00 00 00 00 02 69 12
		39 01 00 00 00 00 02 6a 13
		39 01 00 00 00 00 02 6b 08
		39 01 00 00 00 00 02 6c 07
		39 01 00 00 00 00 02 6d 07
		39 01 00 00 00 00 02 6e 07
		39 01 00 00 00 00 02 6f 07
		39 01 00 00 00 00 02 70 07
		39 01 00 00 00 00 02 71 02
		39 01 00 00 00 00 02 72 2A
		39 01 00 00 00 00 02 73 29
		39 01 00 00 00 00 02 74 28
		39 01 00 00 00 00 02 75 22
		39 01 00 00 00 00 02 76 23
		39 01 00 00 00 00 02 77 10
		39 01 00 00 00 00 02 78 11
		39 01 00 00 00 00 02 79 12
		39 01 00 00 00 00 02 7a 13
		39 01 00 00 00 00 02 7b 08
		39 01 00 00 00 00 02 7c 07
		39 01 00 00 00 00 02 7d 07
		39 01 00 00 00 00 02 7e 07
		39 01 00 00 00 00 02 7f 07
		39 01 00 00 00 00 02 80 07
		39 01 00 00 00 00 02 97 21
		39 01 00 00 00 00 02 d0 01
		39 01 00 00 00 00 02 d1 10
		39 01 00 00 00 00 02 d2 01
		39 01 00 00 00 00 02 d3 11
		39 01 00 00 00 00 02 d4 10
		39 01 00 00 00 00 02 d5 00
		39 01 00 00 00 00 02 d6 00
		39 01 00 00 00 00 02 d7 00
		39 01 00 00 00 00 02 d8 00
		39 01 00 00 00 00 02 d9 44
		39 01 00 00 00 00 02 da 04
		39 01 00 00 00 00 02 db 44
		39 01 00 00 00 00 02 dc 00
		39 01 00 00 00 00 02 dd 55
		39 01 00 00 00 00 02 de 00
		39 01 00 00 00 00 02 B1 00
		39 01 00 00 00 00 02 B2 73
		39 01 00 00 00 00 02 B3 34
		39 01 00 00 00 00 02 a0 00
		39 01 00 00 00 00 02 a2 07
		39 01 00 00 00 00 02 a3 2E
		39 01 00 00 00 00 02 a6 11
		39 01 00 00 00 00 02 a7 02
		39 01 00 00 00 00 02 ae 14
		39 01 00 00 00 00 02 e3 00
		39 01 00 00 00 00 04 FF 78 07 07
		39 01 00 00 00 00 02 3A AF
		39 01 00 00 00 00 02 37 00
		39 01 00 00 00 00 02 12 22
		39 01 00 00 00 00 04 FF 78 07 08
		39 01 00 00 00 00 02 09 0A
		39 01 00 00 00 00 04 FF 78 07 02
		39 01 00 00 00 00 02 00 00
		39 01 00 00 00 00 02 01 00
		39 01 00 00 00 00 02 02 00
		39 01 00 00 00 00 02 03 20
		39 01 00 00 00 00 02 04 00
		39 01 00 00 00 00 02 05 4F
		39 01 00 00 00 00 02 06 00
		39 01 00 00 00 00 02 07 73
		39 01 00 00 00 00 02 08 00
		39 01 00 00 00 00 02 09 90
		39 01 00 00 00 00 02 0A 00
		39 01 00 00 00 00 02 0B A8
		39 01 00 00 00 00 02 0C 00
		39 01 00 00 00 00 02 0D BC
		39 01 00 00 00 00 02 0E 00
		39 01 00 00 00 00 02 0F CF
		39 01 00 00 00 00 02 10 00
		39 01 00 00 00 00 02 11 DF
		39 01 00 00 00 00 02 12 01
		39 01 00 00 00 00 02 13 16
		39 01 00 00 00 00 02 14 01
		39 01 00 00 00 00 02 15 3E
		39 01 00 00 00 00 02 16 01
		39 01 00 00 00 00 02 17 78
		39 01 00 00 00 00 02 18 01
		39 01 00 00 00 00 02 19 A4
		39 01 00 00 00 00 02 1A 01
		39 01 00 00 00 00 02 1B E4
		39 01 00 00 00 00 02 1C 02
		39 01 00 00 00 00 02 1D 17
		39 01 00 00 00 00 02 1E 02
		39 01 00 00 00 00 02 1F 18
		39 01 00 00 00 00 02 20 02
		39 01 00 00 00 00 02 21 48
		39 01 00 00 00 00 02 22 02
		39 01 00 00 00 00 02 23 80
		39 01 00 00 00 00 02 24 02
		39 01 00 00 00 00 02 25 A5
		39 01 00 00 00 00 02 26 02
		39 01 00 00 00 00 02 27 D8
		39 01 00 00 00 00 02 28 02
		39 01 00 00 00 00 02 29 FB
		39 01 00 00 00 00 02 2A 03
		39 01 00 00 00 00 02 2B 29
		39 01 00 00 00 00 02 2C 03
		39 01 00 00 00 00 02 2D 37
		39 01 00 00 00 00 02 2E 03
		39 01 00 00 00 00 02 2F 47
		39 01 00 00 00 00 02 30 03
		39 01 00 00 00 00 02 31 59
		39 01 00 00 00 00 02 32 03
		39 01 00 00 00 00 02 33 6D
		39 01 00 00 00 00 02 34 03
		39 01 00 00 00 00 02 35 85
		39 01 00 00 00 00 02 36 03
		39 01 00 00 00 00 02 37 A4
		39 01 00 00 00 00 02 38 03
		39 01 00 00 00 00 02 39 D3
		39 01 00 00 00 00 02 3A 03
		39 01 00 00 00 00 02 3B E6
		39 01 00 00 00 00 02 3C 00
		39 01 00 00 00 00 02 3D 00
		39 01 00 00 00 00 02 3E 00
		39 01 00 00 00 00 02 3F 20
		39 01 00 00 00 00 02 40 00
		39 01 00 00 00 00 02 41 4F
		39 01 00 00 00 00 02 42 00
		39 01 00 00 00 00 02 43 73
		39 01 00 00 00 00 02 44 00
		39 01 00 00 00 00 02 45 90
		39 01 00 00 00 00 02 46 00
		39 01 00 00 00 00 02 47 A8
		39 01 00 00 00 00 02 48 00
		39 01 00 00 00 00 02 49 BC
		39 01 00 00 00 00 02 4A 00
		39 01 00 00 00 00 02 4B CF
		39 01 00 00 00 00 02 4C 00
		39 01 00 00 00 00 02 4D DF
		39 01 00 00 00 00 02 4E 01
		39 01 00 00 00 00 02 4F 16
		39 01 00 00 00 00 02 50 01
		39 01 00 00 00 00 02 51 3E
		39 01 00 00 00 00 02 52 01
		39 01 00 00 00 00 02 53 78
		39 01 00 00 00 00 02 54 01
		39 01 00 00 00 00 02 55 A4
		39 01 00 00 00 00 02 56 01
		39 01 00 00 00 00 02 57 E4
		39 01 00 00 00 00 02 58 02
		39 01 00 00 00 00 02 59 17
		39 01 00 00 00 00 02 5A 02
		39 01 00 00 00 00 02 5B 18
		39 01 00 00 00 00 02 5C 02
		39 01 00 00 00 00 02 5D 48
		39 01 00 00 00 00 02 5E 02
		39 01 00 00 00 00 02 5F 80
		39 01 00 00 00 00 02 60 02
		39 01 00 00 00 00 02 61 A5
		39 01 00 00 00 00 02 62 02
		39 01 00 00 00 00 02 63 D8
		39 01 00 00 00 00 02 64 02
		39 01 00 00 00 00 02 65 FB
		39 01 00 00 00 00 02 66 03
		39 01 00 00 00 00 02 67 29
		39 01 00 00 00 00 02 68 03
		39 01 00 00 00 00 02 69 37
		39 01 00 00 00 00 02 6A 03
		39 01 00 00 00 00 02 6B 47
		39 01 00 00 00 00 02 6C 03
		39 01 00 00 00 00 02 6D 59
		39 01 00 00 00 00 02 6E 03
		39 01 00 00 00 00 02 6F 6D
		39 01 00 00 00 00 02 70 03
		39 01 00 00 00 00 02 71 85
		39 01 00 00 00 00 02 72 03
		39 01 00 00 00 00 02 73 A4
		39 01 00 00 00 00 02 74 03
		39 01 00 00 00 00 02 75 D3
		39 01 00 00 00 00 02 76 03
		39 01 00 00 00 00 02 77 E6
		39 01 00 00 00 00 02 78 01
		39 01 00 00 00 00 02 79 01
		39 01 00 00 00 00 04 FF 78 07 03
		39 01 00 00 00 00 02 00 00
		39 01 00 00 00 00 02 01 00
		39 01 00 00 00 00 02 02 00
		39 01 00 00 00 00 02 03 1F
		39 01 00 00 00 00 02 04 00
		39 01 00 00 00 00 02 05 4E
		39 01 00 00 00 00 02 06 00
		39 01 00 00 00 00 02 07 72
		39 01 00 00 00 00 02 08 00
		39 01 00 00 00 00 02 09 8F
		39 01 00 00 00 00 02 0A 00
		39 01 00 00 00 00 02 0B A7
		39 01 00 00 00 00 02 0C 00
		39 01 00 00 00 00 02 0D BB
		39 01 00 00 00 00 02 0E 00
		39 01 00 00 00 00 02 0F CE
		39 01 00 00 00 00 02 10 00
		39 01 00 00 00 00 02 11 DE
		39 01 00 00 00 00 02 12 01
		39 01 00 00 00 00 02 13 14
		39 01 00 00 00 00 02 14 01
		39 01 00 00 00 00 02 15 3B
		39 01 00 00 00 00 02 16 01
		39 01 00 00 00 00 02 17 76
		39 01 00 00 00 00 02 18 01
		39 01 00 00 00 00 02 19 A1
		39 01 00 00 00 00 02 1A 01
		39 01 00 00 00 00 02 1B E1
		39 01 00 00 00 00 02 1C 02
		39 01 00 00 00 00 02 1D 14
		39 01 00 00 00 00 02 1E 02
		39 01 00 00 00 00 02 1F 15
		39 01 00 00 00 00 02 20 02
		39 01 00 00 00 00 02 21 45
		39 01 00 00 00 00 02 22 02
		39 01 00 00 00 00 02 23 7E
		39 01 00 00 00 00 02 24 02
		39 01 00 00 00 00 02 25 A3
		39 01 00 00 00 00 02 26 02
		39 01 00 00 00 00 02 27 D6
		39 01 00 00 00 00 02 28 02
		39 01 00 00 00 00 02 29 F9
		39 01 00 00 00 00 02 2A 03
		39 01 00 00 00 00 02 2B 27
		39 01 00 00 00 00 02 2C 03
		39 01 00 00 00 00 02 2D 36
		39 01 00 00 00 00 02 2E 03
		39 01 00 00 00 00 02 2F 45
		39 01 00 00 00 00 02 30 03
		39 01 00 00 00 00 02 31 57
		39 01 00 00 00 00 02 32 03
		39 01 00 00 00 00 02 33 6C
		39 01 00 00 00 00 02 34 03
		39 01 00 00 00 00 02 35 84
		39 01 00 00 00 00 02 36 03
		39 01 00 00 00 00 02 37 A1
		39 01 00 00 00 00 02 38 03
		39 01 00 00 00 00 02 39 CF
		39 01 00 00 00 00 02 3A 03
		39 01 00 00 00 00 02 3B E6
		39 01 00 00 00 00 02 3C 00
		39 01 00 00 00 00 02 3D 00
		39 01 00 00 00 00 02 3E 00
		39 01 00 00 00 00 02 3F 1F
		39 01 00 00 00 00 02 40 00
		39 01 00 00 00 00 02 41 4E
		39 01 00 00 00 00 02 42 00
		39 01 00 00 00 00 02 43 72
		39 01 00 00 00 00 02 44 00
		39 01 00 00 00 00 02 45 8F
		39 01 00 00 00 00 02 46 00
		39 01 00 00 00 00 02 47 A7
		39 01 00 00 00 00 02 48 00
		39 01 00 00 00 00 02 49 BB
		39 01 00 00 00 00 02 4A 00
		39 01 00 00 00 00 02 4B CE
		39 01 00 00 00 00 02 4C 00
		39 01 00 00 00 00 02 4D DE
		39 01 00 00 00 00 02 4E 01
		39 01 00 00 00 00 02 4F 14
		39 01 00 00 00 00 02 50 01
		39 01 00 00 00 00 02 51 3B
		39 01 00 00 00 00 02 52 01
		39 01 00 00 00 00 02 53 76
		39 01 00 00 00 00 02 54 01
		39 01 00 00 00 00 02 55 A1
		39 01 00 00 00 00 02 56 01
		39 01 00 00 00 00 02 57 E1
		39 01 00 00 00 00 02 58 02
		39 01 00 00 00 00 02 59 14
		39 01 00 00 00 00 02 5A 02
		39 01 00 00 00 00 02 5B 15
		39 01 00 00 00 00 02 5C 02
		39 01 00 00 00 00 02 5D 45
		39 01 00 00 00 00 02 5E 02
		39 01 00 00 00 00 02 5F 7E
		39 01 00 00 00 00 02 60 02
		39 01 00 00 00 00 02 61 A3
		39 01 00 00 00 00 02 62 02
		39 01 00 00 00 00 02 63 D6
		39 01 00 00 00 00 02 64 02
		39 01 00 00 00 00 02 65 F9
		39 01 00 00 00 00 02 66 03
		39 01 00 00 00 00 02 67 27
		39 01 00 00 00 00 02 68 03
		39 01 00 00 00 00 02 69 36
		39 01 00 00 00 00 02 6A 03
		39 01 00 00 00 00 02 6B 45
		39 01 00 00 00 00 02 6C 03
		39 01 00 00 00 00 02 6D 57
		39 01 00 00 00 00 02 6E 03
		39 01 00 00 00 00 02 6F 6C
		39 01 00 00 00 00 02 70 03
		39 01 00 00 00 00 02 71 84
		39 01 00 00 00 00 02 72 03
		39 01 00 00 00 00 02 73 A1
		39 01 00 00 00 00 02 74 03
		39 01 00 00 00 00 02 75 CF
		39 01 00 00 00 00 02 76 03
		39 01 00 00 00 00 02 77 E6
		39 01 00 00 00 00 02 78 01
		39 01 00 00 00 00 02 79 01
		39 01 00 00 00 00 04 FF 78 07 04
		39 01 00 00 00 00 02 00 00
		39 01 00 00 00 00 02 01 00
		39 01 00 00 00 00 02 02 00
		39 01 00 00 00 00 02 03 24
		39 01 00 00 00 00 02 04 00
		39 01 00 00 00 00 02 05 57
		39 01 00 00 00 00 02 06 00
		39 01 00 00 00 00 02 07 7B
		39 01 00 00 00 00 02 08 00
		39 01 00 00 00 00 02 09 98
		39 01 00 00 00 00 02 0A 00
		39 01 00 00 00 00 02 0B B1
		39 01 00 00 00 00 02 0C 00
		39 01 00 00 00 00 02 0D C6
		39 01 00 00 00 00 02 0E 00
		39 01 00 00 00 00 02 0F D7
		39 01 00 00 00 00 02 10 00
		39 01 00 00 00 00 02 11 E8
		39 01 00 00 00 00 02 12 01
		39 01 00 00 00 00 02 13 1B
		39 01 00 00 00 00 02 14 01
		39 01 00 00 00 00 02 15 42
		39 01 00 00 00 00 02 16 01
		39 01 00 00 00 00 02 17 7B
		39 01 00 00 00 00 02 18 01
		39 01 00 00 00 00 02 19 A5
		39 01 00 00 00 00 02 1A 01
		39 01 00 00 00 00 02 1B E4
		39 01 00 00 00 00 02 1C 02
		39 01 00 00 00 00 02 1D 16
		39 01 00 00 00 00 02 1E 02
		39 01 00 00 00 00 02 1F 17
		39 01 00 00 00 00 02 20 02
		39 01 00 00 00 00 02 21 47
		39 01 00 00 00 00 02 22 02
		39 01 00 00 00 00 02 23 7E
		39 01 00 00 00 00 02 24 02
		39 01 00 00 00 00 02 25 A3
		39 01 00 00 00 00 02 26 02
		39 01 00 00 00 00 02 27 D7
		39 01 00 00 00 00 02 28 02
		39 01 00 00 00 00 02 29 F9
		39 01 00 00 00 00 02 2A 03
		39 01 00 00 00 00 02 2B 27
		39 01 00 00 00 00 02 2C 03
		39 01 00 00 00 00 02 2D 35
		39 01 00 00 00 00 02 2E 03
		39 01 00 00 00 00 02 2F 45
		39 01 00 00 00 00 02 30 03
		39 01 00 00 00 00 02 31 57
		39 01 00 00 00 00 02 32 03
		39 01 00 00 00 00 02 33 6C
		39 01 00 00 00 00 02 34 03
		39 01 00 00 00 00 02 35 84
		39 01 00 00 00 00 02 36 03
		39 01 00 00 00 00 02 37 A1
		39 01 00 00 00 00 02 38 03
		39 01 00 00 00 00 02 39 D1
		39 01 00 00 00 00 02 3A 03
		39 01 00 00 00 00 02 3B E6
		39 01 00 00 00 00 02 3C 00
		39 01 00 00 00 00 02 3D 00
		39 01 00 00 00 00 02 3E 00
		39 01 00 00 00 00 02 3F 24
		39 01 00 00 00 00 02 40 00
		39 01 00 00 00 00 02 41 57
		39 01 00 00 00 00 02 42 00
		39 01 00 00 00 00 02 43 7B
		39 01 00 00 00 00 02 44 00
		39 01 00 00 00 00 02 45 98
		39 01 00 00 00 00 02 46 00
		39 01 00 00 00 00 02 47 B1
		39 01 00 00 00 00 02 48 00
		39 01 00 00 00 00 02 49 C6
		39 01 00 00 00 00 02 4A 00
		39 01 00 00 00 00 02 4B D7
		39 01 00 00 00 00 02 4C 00
		39 01 00 00 00 00 02 4D E8
		39 01 00 00 00 00 02 4E 01
		39 01 00 00 00 00 02 4F 1B
		39 01 00 00 00 00 02 50 01
		39 01 00 00 00 00 02 51 42
		39 01 00 00 00 00 02 52 01
		39 01 00 00 00 00 02 53 7B
		39 01 00 00 00 00 02 54 01
		39 01 00 00 00 00 02 55 A5
		39 01 00 00 00 00 02 56 01
		39 01 00 00 00 00 02 57 E4
		39 01 00 00 00 00 02 58 02
		39 01 00 00 00 00 02 59 16
		39 01 00 00 00 00 02 5A 02
		39 01 00 00 00 00 02 5B 17
		39 01 00 00 00 00 02 5C 02
		39 01 00 00 00 00 02 5D 47
		39 01 00 00 00 00 02 5E 02
		39 01 00 00 00 00 02 5F 7E
		39 01 00 00 00 00 02 60 02
		39 01 00 00 00 00 02 61 A3
		39 01 00 00 00 00 02 62 02
		39 01 00 00 00 00 02 63 D7
		39 01 00 00 00 00 02 64 02
		39 01 00 00 00 00 02 65 F9
		39 01 00 00 00 00 02 66 03
		39 01 00 00 00 00 02 67 27
		39 01 00 00 00 00 02 68 03
		39 01 00 00 00 00 02 69 35
		39 01 00 00 00 00 02 6A 03
		39 01 00 00 00 00 02 6B 45
		39 01 00 00 00 00 02 6C 03
		39 01 00 00 00 00 02 6D 57
		39 01 00 00 00 00 02 6E 03
		39 01 00 00 00 00 02 6F 6C
		39 01 00 00 00 00 02 70 03
		39 01 00 00 00 00 02 71 84
		39 01 00 00 00 00 02 72 03
		39 01 00 00 00 00 02 73 A1
		39 01 00 00 00 00 02 74 03
		39 01 00 00 00 00 02 75 D1
		39 01 00 00 00 00 02 76 03
		39 01 00 00 00 00 02 77 E6
		39 01 00 00 00 00 02 78 01
		39 01 00 00 00 00 02 79 01
		39 01 00 00 00 00 04 FF 78 07 05
		39 01 00 00 00 00 02 03 40
		39 01 00 00 00 00 02 04 00
		39 01 00 00 00 00 04 FF 78 07 00
		39 01 00 00 00 00 03 51 00 00
		39 01 00 00 00 00 02 53 2C
		39 01 00 00 00 00 02 55 00
		39 01 00 00 00 00 03 68 02 01
		39 01 00 00 64 00 02 11 00
		39 01 00 00 14 00 02 29 00];
		hw,lcdkit-panel-on-command-state = "dsi_lp_mode";
		hw,lcdkit-panel-display-on-command = [05 01 00 00 64 00 02 11 00
                    05 01 00 00 14 00 02 29 00];
		hw,lcdkit-panel-off-command = [05 01 00 00 14 00 02 28 00
					05 01 00 00 64 00 02 10 00];
		hw,lcdkit-panel-off-command-state = "dsi_lp_mode";
		hw,lcdkit-panel-backlight-command = [39 01 00 00 00 00 03 51 00 00];
		hw,lcdkit-panel-backlight-command-state = "dsi_lp_mode";
		hw,lcdkit-panel-cabc-off-command = [15 01 00 00 0a 00 02 55 00];
		hw,lcdkit-panel-cabc-off-command-state = "dsi_lp_mode";
		hw,lcdkit-panel-cabc-ui-command = [15 01 00 00 0a 00 02 55 01
				  15 01 00 00 0a 00 02 53 2C];
		hw,lcdkit-panel-cabc-ui-command-state = "dsi_lp_mode";
		hw,lcdkit-panel-cabc-still-command = [15 01 00 00 0a 00 02 55 02
				     15 01 00 00 0a 00 02 53 2C];
		hw,lcdkit-panel-cabc-still-command-state = "dsi_lp_mode";
		hw,lcdkit-panel-cabc-moving-command = [15 01 00 00 0a 00 02 55 03
				      15 01 00 00 0a 00 02 53 2C];
		hw,lcdkit-panel-cabc-moving-command-state = "dsi_lp_mode";
		hw,lcdkit-panel-cabc-support = <0>;
		hw,lcdkit-panel-dot-inversion-command = [39 01 00 00 00 00 04 FF 78 07 01
						39 01 00 00 00 00 02 31 21
						39 01 00 00 00 00 04 FF 78 07 00];
		hw,lcdkit-panel-dot-inversion-command-state = "dsi_lp_mode";
		hw,lcdkit-panel-column-inversion-command = [39 01 00 00 00 00 04 FF 78 07 01
                                                39 01 00 00 00 00 02 31 20
                                                39 01 00 00 00 00 04 FF 78 07 00];
		hw,lcdkit-panel-column-inversion-command-state = "dsi_lp_mode";
		hw,lcdkit-panel-inversion-support = <1>;
		hw,lcdkit-panel-forword-scan-command = [39 01 00 00 00 00 04 FF 78 07 00
                                                39 01 00 00 00 00 02 36 00
                                                39 01 00 00 00 00 04 FF 78 07 00];
		hw,lcdkit-panel-forword-scan-command-state = "dsi_lp_mode";
		hw,lcdkit-panel-revert-scan-command = [39 01 00 00 00 00 04 FF 78 07 00
                                                39 01 00 00 00 00 02 36 C0
                                                39 01 00 00 00 00 04 FF 78 07 00];
		hw,lcdkit-panel-revert-scan-command-state = "dsi_lp_mode";
		hw,lcdkit-panel-scan-support = <1>;
		hw,lcdkit-panel-display-region-support = <0>;
		hw,lcdkit-panel-checksum-support = <0>;
		hw,lcdkit-panel-esd-reg-command = [14 01 00 00 0a 00 01 0a];
		hw,lcdkit-panel-esd-reg-command-state = "dsi_lp_mode";
		hw,lcdkit-panel-esd-value = [9c];
		hw,lcdkit-panel-esd-support = <0>;
		hw,lcdkit-panel-check-reg-command = [14 01 00 00 0a 00 01 0a];
		hw,lcdkit-panel-check-reg-value = [9c];
		hw,lcdkit-panel-check-reg-command-state = "dsi_lp_mode";
		hw,lcdkit-panel-check-reg-support = <1>;
		hw,lcdkit-panel-bl-maxnit-command = [14 01 00 00 00 00 01 db];
		hw,lcdkit-panel-bl-maxnit-command-state = "dsi_lp_mode";
		hw,lcdkit-panel-mipi-detect-support = <0>;
		hw,lcdkit-panel-shutdown-sleep-support = <0>;
		hw,lcdkit-dsi-bpp = <24>;
		hw,lcdkit-panel-cmd-type = <0>;
		hw,lcdkit-pixel-packing = <0>;
		hw,lcdkit-underflow-color = <0x00>;
		hw,lcdkit-border-color = <0>;
		hw,lcdkit-panel-orientation = <0>;
		hw,lcdkit-brightness-max-level = <1023>;
		hw,lcdkit-bl-min-level = <16>;
		hw,lcdkit-bl-max-level = <1023>;
		hw,lcdkit-interleave-mode = <0>;
		hw,lcdkit-te-using-te-pin;
		hw,lcdkit-h-sync-pulse = <1>;
		hw,lcdkit-bllp-power-mode;
		hw,lcdkit-bllp-eof-power-mode;
		hw,lcdkit-traffic-mode = "burst_mode";
		hw,lcdkit-te-dcs-command = <1>;
		hw,lcdkit-te-pin-select = <1>;
		hw,lcdkit-virtual-channel-id = <0>;
		hw,lcdkit-color-order = "rgb_swap_rgb";
		hw,lcdkit-lane-0-state;
		hw,lcdkit-lane-1-state;
		hw,lcdkit-lane-2-state;
		hw,lcdkit-h-left-border = <0>;
		hw,lcdkit-h-right-border = <0>;
		hw,lcdkit-v-top-border = <0>;
		hw,lcdkit-v-bottom-border = <0>;
		hw,lcdkit-panel-framerate = <60>;
		hw,lcdkit-panel-clockrate = <668340000>;
		hw,lcdkit-panel-timings = [21 1D 06 07 04 03 04 A0
			21 1D 06 07 04 03 04 A0
			21 1D 06 07 04 03 04 A0
			21 1D 06 07 04 03 04 A0
			21 14 06 07 04 03 04 A0];
		hw,lcdkit-panel-timings-phy-v2 = [21 1D 06 07 04 03 04 A0
			21 1D 06 07 04 03 04 A0
			21 1D 06 07 04 03 04 A0
			21 1D 06 07 04 03 04 A0
			21 14 06 07 04 03 04 A0];
		hw,lcdkit-t-clk-pre = <0x27>;
		hw,lcdkit-t-clk-post = <0x0C>;
		hw,lcdkit-tx-eot-append;
		hw,lcdkit-stream = <0>;
		hw,lcdkit-lp11-init;
		hw,lcdkit-mdp-trigger = "none";
		hw,lcdkit-dma-trigger = "trigger_sw";
		hw,lcdkit-bl-pmic-control-type = "bl_ctrl_dcs";
		qcom,panel-supply-entries = <&dsi_panel_pwr_supply>;
		hw,lcdkit-lane-map = "lane_map_0123";
		hw,lcdkit-delay-before-bl = <0>;
		hw,lcdkit-mipi-regulator-mode = <1>;
		hw,lcdkit-bl-en-gpio = <0>;
		hw,lcdkit-delay-af-rst-off = <20>;
		hw,lcdkit-delay-af-blic-init = <0>;
		hw,lcdkit-bl-level-limit-percent = <100>;
		hw,lcdkit-use-second-ic-for-esd = <0>;
		hw,lcdkit-esd-check-num = <3>;
		hw,lcdkit-tp-reset-gpio = <64>;
		hw,lcdkit-panel-bl-maxnit = <470>;
		hw,lcdkit-panel-getblmaxnit-type = <1>;
		hw,lcdkit-panel-getblmaxnit-offset = <360>;
		hw,lcdkit-h-back-porch = <78>;
		hw,lcdkit-h-front-porch = <80>;
		hw,lcdkit-h-pulse-width = <10>;
		hw,lcdkit-v-back-porch = <16>;
		hw,lcdkit-v-pulse-width = <8>;
		hw,lcdkit-v-front-porch = <24>;
		hw,lcdkit-h-sync-skew = <0>;
		hw,lcdkit-lcd-type = <0>;
		hw,lcdkit-panel-pt-test-support = <1>;
		hw,lcdkit-bias-power-ctrl-mode = <0x01>;
		hw,lcdkit-bl-dcs-level-trans-mode = <0>;
		hw,lcdkit-bl-dcs-reg              = <0x51>;
		hw,lcdkit-iovcc-power-ctrl-mode = <0x01>;
		hw,lcdkit-vci-power-ctrl-mode = <0x01>;
		hw,lcdkit-id0-gpio = <89>;
		hw,lcdkit-id1-gpio = <66>;
		hw,lcdkit-reset-gpio = <61>;
		hw,lcdkit-te-gpio = <0>;
		hw,lcdkit-vsp-gpio = <0>;
		hw,lcdkit-vsn-gpio = <0>;
		hw,lcdkit-iovcc-gpio = <0>;
		hw,lcdkit-vci-gpio = <0>;
		hw,lcdkit-bl-gpio = <0>;
		hw,lcdkit-iovcc-on-is-need-reset = <0>;
		hw,lcdkit-vsn-on-is-need-reset = <0>;
		hw,lcdkit-lcd-vsp = <5500000>;
		hw,lcdkit-lcd-vsn = <5500000>;
		hw,lcdkit-lcd-rst-first-high = <2>;
		hw,lcdkit-lcd-rst-low = <2>;
		hw,lcdkit-lcd-rst-second-high = <11>;
		hw,lcdkit-delay-af-vci-on = <0>;
		hw,lcdkit-delay-af-iovcc-on = <1>;
		hw,lcdkit-delay-af-bias-on = <0>;
		hw,lcdkit-delay-af-vsp-on = <2>;
		hw,lcdkit-delay-af-vsn-on = <3>;
		hw,lcdkit-delay-af-lp11 = <0>;
		hw,lcdkit-delay-af-tp-reset = <25>;
		hw,lcdkit-delay-af-vsn-off = <1>;
		hw,lcdkit-delay-af-vsp-off = <1>;
		hw,lcdkit-delay-af-bias-off = <0>;
		hw,lcdkit-delay-af-iovcc-off = <0>;
		hw,lcdkit-delay-af-vci-off = <0>;
		hw,lcdkit-panel-off-reset-high = <0>;
		hw,lcdkit-pan-dis-dimming-bf-sleep-in = <0>;
		hw,lcdkit-panel-disable-dimming-command = [15 01 00 00 00 00 02 53 04];
		hw,lcdkit-panel-disable-dimming-command-state = "dsi_lp_mode";
		hw,lcdkit-panel-enable-dimming-command = [15 01 00 00 00 00 02 53 2C];
		hw,lcdkit-panel-enable-dimming-command-state = "dsi_lp_mode";
    };
};
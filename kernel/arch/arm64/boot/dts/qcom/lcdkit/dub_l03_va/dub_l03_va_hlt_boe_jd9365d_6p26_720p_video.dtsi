/* Copyright (c) 2013, The Linux Foundation. All rights reserved.
 *
 * This program is free software; you can redistribute it and/or modify
 * it under the terms of the GNU General Public License version 2 and
 * only version 2 as published by the Free Software Foundation.
 *
 * This program is distributed in the hope that it will be useful,
 * but WITHOUT ANY WARRANTY; without even the implied warranty of
 * MERCHANTABILITY or FITNESS FOR A PARTICULAR PURPOSE.  See the
 * GNU General Public License for more details.
 */

/*-------------------------------------------------------------------------
 * This file is autogenerated file using gcdb parser. Please do not edit it.
 * Update input XML file to add a new entry or update variable in this file
 * VERSION = 1.1
 *-----------------------------------------------------------------------*/
/ {
	dsi_dub_l03_va_hlt_boe_jd9365d_6p26_720p_video: lcdkit_dub_l03_va_hlt_boe_jd9365d_6p26_720p_video {
		compatible = "hlt-boe-jd9365d-6p26-720p-video";
		hw,lcdkit-panel-name = "HLT_BOE_JD9365D 6P26 VIDEO TFT 720 x 1520";
		hw,lcdkit-panel-type = <0x01>;
		hw,lcdkit-panel-xres = <720>;
		hw,lcdkit-panel-yres = <1520>;
		hw,lcdkit-panel-width = <68>;
		hw,lcdkit-panel-height = <144>;
		hw,lcdkit-panel-on-command = [39 01 00 00 00 00 02 E0 00
		39 01 00 00 00 00 02 E1 93
		39 01 00 00 00 00 02 E2 65
		39 01 00 00 00 00 02 E3 F8
		39 01 00 00 00 00 02 80 02
		39 01 00 00 00 00 02 E0 01
		39 01 00 00 00 00 02 00 00
		39 01 00 00 00 00 02 01 94
		39 01 00 00 00 00 02 03 00
		39 01 00 00 00 00 02 04 A1
		39 01 00 00 00 00 02 17 10
		39 01 00 00 00 00 02 18 0F
		39 01 00 00 00 00 02 19 00
		39 01 00 00 00 00 02 1A 10
		39 01 00 00 00 00 02 1B 0F
		39 01 00 00 00 00 02 1C 00
		39 01 00 00 00 00 02 24 FE
		39 01 00 00 00 00 02 25 20
		39 01 00 00 00 00 02 27 22
		39 01 00 00 00 00 02 35 22
		39 01 00 00 00 00 02 37 09
		39 01 00 00 00 00 02 38 04
		39 01 00 00 00 00 02 39 00
		39 01 00 00 00 00 02 3A 01
		39 01 00 00 00 00 02 3C 64
		39 01 00 00 00 00 02 3D FF
		39 01 00 00 00 00 02 3E FF
		39 01 00 00 00 00 02 3F FF
		39 01 00 00 00 00 02 40 04
		39 01 00 00 00 00 02 41 BE
		39 01 00 00 00 00 02 42 6B
		39 01 00 00 00 00 02 43 08
		39 01 00 00 00 00 02 44 11
		39 01 00 00 00 00 02 45 28
		39 01 00 00 00 00 02 4B 04
		39 01 00 00 00 00 02 55 0F
		39 01 00 00 00 00 02 56 01
		39 01 00 00 00 00 02 57 4D
		39 01 00 00 00 00 02 58 0A
		39 01 00 00 00 00 02 59 0A
		39 01 00 00 00 00 02 5A 19
		39 01 00 00 00 00 02 5B 24
		39 01 00 00 00 00 02 5C 15
		39 01 00 00 00 00 02 5D 78
		39 01 00 00 00 00 02 5E 66
		39 01 00 00 00 00 02 5F 58
		39 01 00 00 00 00 02 60 4D
		39 01 00 00 00 00 02 61 4A
		39 01 00 00 00 00 02 62 3C
		39 01 00 00 00 00 02 63 40
		39 01 00 00 00 00 02 64 2A
		39 01 00 00 00 00 02 65 43
		39 01 00 00 00 00 02 66 41
		39 01 00 00 00 00 02 67 3F
		39 01 00 00 00 00 02 68 5B
		39 01 00 00 00 00 02 69 48
		39 01 00 00 00 00 02 6A 4F
		39 01 00 00 00 00 02 6B 41
		39 01 00 00 00 00 02 6C 3E
		39 01 00 00 00 00 02 6D 32
		39 01 00 00 00 00 02 6E 21
		39 01 00 00 00 00 02 6F 02
		39 01 00 00 00 00 02 70 78
		39 01 00 00 00 00 02 71 66
		39 01 00 00 00 00 02 72 58
		39 01 00 00 00 00 02 73 4D
		39 01 00 00 00 00 02 74 4A
		39 01 00 00 00 00 02 75 3C
		39 01 00 00 00 00 02 76 40
		39 01 00 00 00 00 02 77 2A
		39 01 00 00 00 00 02 78 43
		39 01 00 00 00 00 02 79 41
		39 01 00 00 00 00 02 7A 3F
		39 01 00 00 00 00 02 7B 5B
		39 01 00 00 00 00 02 7C 48
		39 01 00 00 00 00 02 7D 4F
		39 01 00 00 00 00 02 7E 41
		39 01 00 00 00 00 02 7F 3E
		39 01 00 00 00 00 02 80 32
		39 01 00 00 00 00 02 81 21
		39 01 00 00 00 00 02 82 02
		39 01 00 00 00 00 02 E0 02
		39 01 00 00 00 00 02 00 41
		39 01 00 00 00 00 02 01 5F
		39 01 00 00 00 00 02 02 5F
		39 01 00 00 00 00 02 03 5F
		39 01 00 00 00 00 02 04 49
		39 01 00 00 00 00 02 05 4B
		39 01 00 00 00 00 02 06 45
		39 01 00 00 00 00 02 07 47
		39 01 00 00 00 00 02 08 43
		39 01 00 00 00 00 02 09 5F
		39 01 00 00 00 00 02 0A 5F
		39 01 00 00 00 00 02 0B 35
		39 01 00 00 00 00 02 0C 5F
		39 01 00 00 00 00 02 0D 5F
		39 01 00 00 00 00 02 0E 5F
		39 01 00 00 00 00 02 0F 5F
		39 01 00 00 00 00 02 10 5F
		39 01 00 00 00 00 02 11 5F
		39 01 00 00 00 00 02 12 5F
		39 01 00 00 00 00 02 13 5F
		39 01 00 00 00 00 02 14 15
		39 01 00 00 00 00 02 15 5E
		39 01 00 00 00 00 02 16 40
		39 01 00 00 00 00 02 17 5F
		39 01 00 00 00 00 02 18 5F
		39 01 00 00 00 00 02 19 5F
		39 01 00 00 00 00 02 1A 48
		39 01 00 00 00 00 02 1B 4A
		39 01 00 00 00 00 02 1C 44
		39 01 00 00 00 00 02 1D 46
		39 01 00 00 00 00 02 1E 42
		39 01 00 00 00 00 02 1F 5F
		39 01 00 00 00 00 02 20 5F
		39 01 00 00 00 00 02 21 35
		39 01 00 00 00 00 02 22 5F
		39 01 00 00 00 00 02 23 5F
		39 01 00 00 00 00 02 24 5F
		39 01 00 00 00 00 02 25 5F
		39 01 00 00 00 00 02 26 5F
		39 01 00 00 00 00 02 27 5F
		39 01 00 00 00 00 02 28 5F
		39 01 00 00 00 00 02 29 5F
		39 01 00 00 00 00 02 2A 15
		39 01 00 00 00 00 02 2B 5E
		39 01 00 00 00 00 02 2C 02
		39 01 00 00 00 00 02 2D 1F
		39 01 00 00 00 00 02 2E 1F
		39 01 00 00 00 00 02 2F 1F
		39 01 00 00 00 00 02 30 06
		39 01 00 00 00 00 02 31 04
		39 01 00 00 00 00 02 32 0A
		39 01 00 00 00 00 02 33 08
		39 01 00 00 00 00 02 34 00
		39 01 00 00 00 00 02 35 1F
		39 01 00 00 00 00 02 36 1E
		39 01 00 00 00 00 02 37 15
		39 01 00 00 00 00 02 38 1F
		39 01 00 00 00 00 02 39 1F
		39 01 00 00 00 00 02 3A 1F
		39 01 00 00 00 00 02 3B 1F
		39 01 00 00 00 00 02 3C 1F
		39 01 00 00 00 00 02 3D 1F
		39 01 00 00 00 00 02 3E 1F
		39 01 00 00 00 00 02 3F 1F
		39 01 00 00 00 00 02 40 15
		39 01 00 00 00 00 02 41 1F
		39 01 00 00 00 00 02 42 03
		39 01 00 00 00 00 02 43 1F
		39 01 00 00 00 00 02 44 1F
		39 01 00 00 00 00 02 45 1F
		39 01 00 00 00 00 02 46 07
		39 01 00 00 00 00 02 47 05
		39 01 00 00 00 00 02 48 0B
		39 01 00 00 00 00 02 49 09
		39 01 00 00 00 00 02 4A 01
		39 01 00 00 00 00 02 4B 1F
		39 01 00 00 00 00 02 4C 1E
		39 01 00 00 00 00 02 4D 15
		39 01 00 00 00 00 02 4E 1F
		39 01 00 00 00 00 02 4F 1F
		39 01 00 00 00 00 02 50 1F
		39 01 00 00 00 00 02 51 1F
		39 01 00 00 00 00 02 52 1F
		39 01 00 00 00 00 02 53 1F
		39 01 00 00 00 00 02 54 1F
		39 01 00 00 00 00 02 55 1F
		39 01 00 00 00 00 02 56 15
		39 01 00 00 00 00 02 57 1F
		39 01 00 00 00 00 02 58 40
		39 01 00 00 00 00 02 59 00
		39 01 00 00 00 00 02 5A 00
		39 01 00 00 00 00 02 5B 30
		39 01 00 00 00 00 02 5C 09
		39 01 00 00 00 00 02 5D 30
		39 01 00 00 00 00 02 5E 01
		39 01 00 00 00 00 02 5F 02
		39 01 00 00 00 00 02 60 00
		39 01 00 00 00 00 02 61 01
		39 01 00 00 00 00 02 62 02
		39 01 00 00 00 00 02 63 0C
		39 01 00 00 00 00 02 64 52
		39 01 00 00 00 00 02 65 00
		39 01 00 00 00 00 02 66 00
		39 01 00 00 00 00 02 67 73
		39 01 00 00 00 00 02 68 0B
		39 01 00 00 00 00 02 69 18
		39 01 00 00 00 00 02 6A 52
		39 01 00 00 00 00 02 6B 08
		39 01 00 00 00 00 02 6C 00
		39 01 00 00 00 00 02 6D 0C
		39 01 00 00 00 00 02 6E 04
		39 01 00 00 00 00 02 6F 48
		39 01 00 00 00 00 02 70 00
		39 01 00 00 00 00 02 71 00
		39 01 00 00 00 00 02 72 06
		39 01 00 00 00 00 02 73 7B
		39 01 00 00 00 00 02 74 00
		39 01 00 00 00 00 02 75 07
		39 01 00 00 00 00 02 76 00
		39 01 00 00 00 00 02 77 ED
		39 01 00 00 00 00 02 78 17
		39 01 00 00 00 00 02 79 02
		39 01 00 00 00 00 02 7A 06
		39 01 00 00 00 00 02 7B 00
		39 01 00 00 00 00 02 7C 00
		39 01 00 00 00 00 02 7D 03
		39 01 00 00 00 00 02 7E 62
		39 01 00 00 00 00 02 E0 04
		39 01 00 00 00 00 02 00 06
		39 01 00 00 00 00 02 03 4E
		39 01 00 00 00 00 02 04 01
		39 01 00 00 00 00 02 09 10
		39 01 00 00 00 00 02 0E 2A
		39 01 00 00 00 00 02 0F 87
		39 01 00 00 00 00 02 96 0A
		39 01 00 00 00 00 02 E0 03
		39 01 00 00 00 00 02 9B 00
		39 01 00 00 00 00 02 E0 05
		39 01 00 00 00 00 02 15 1B
		39 01 00 00 00 00 02 E0 00
		39 01 00 00 00 00 02 53 2C
		39 01 00 00 00 00 02 51 00
		39 01 00 00 5F 00 02 11 00
		39 01 00 00 05 00 02 29 00
		39 01 00 00 00 00 02 35 00];
		hw,lcdkit-panel-on-command-state = "dsi_lp_mode";
		hw,lcdkit-panel-display-on-command = [05 01 00 00 5F 00 02 11 00
				05 01 00 00 14 00 02 29 00];
		hw,lcdkit-panel-off-command = [05 01 00 00 32 00 02 28 00
				05 01 00 00 78 00 02 10 00];
		hw,lcdkit-panel-off-command-state = "dsi_lp_mode";
		hw,lcdkit-panel-backlight-command = [39 01 00 00 00 00 02 51 00];
		hw,lcdkit-panel-backlight-command-state = "dsi_lp_mode";
		hw,lcdkit-panel-cabc-off-command = [15 01 00 00 0a 00 02 55 00];
		hw,lcdkit-panel-cabc-off-command-state = "dsi_lp_mode";
		hw,lcdkit-panel-cabc-ui-command = [15 01 00 00 0a 00 02 55 01
				  15 01 00 00 0a 00 02 53 2C];
		hw,lcdkit-panel-cabc-ui-command-state = "dsi_lp_mode";
		hw,lcdkit-panel-cabc-still-command = [15 01 00 00 0a 00 02 55 02
				     15 01 00 00 0a 00 02 53 2C];
		hw,lcdkit-panel-cabc-still-command-state = "dsi_lp_mode";
		hw,lcdkit-panel-cabc-moving-command = [15 01 00 00 0a 00 02 55 03
				      15 01 00 00 0a 00 02 53 2C];
		hw,lcdkit-panel-cabc-moving-command-state = "dsi_lp_mode";
		hw,lcdkit-panel-cabc-support = <0>;
		hw,lcdkit-panel-dot-inversion-command = [39 01 00 00 00 00 02 E0 01
			39 01 00 00 00 00 02 38 02
			39 01 00 00 00 00 02 E0 00];
		hw,lcdkit-panel-dot-inversion-command-state = "dsi_lp_mode";
		hw,lcdkit-panel-column-inversion-command = [39 01 00 00 00 00 02 E0 00
						39 01 00 00 00 00 02 E1 93
						39 01 00 00 00 00 02 E2 65
						39 01 00 00 00 00 02 E3 F8
						39 01 00 00 00 00 02 80 03
						39 01 00 00 00 00 02 E0 01
                        39 01 00 00 00 00 02 38 04
                        39 01 00 00 00 00 02 E0 00];
		hw,lcdkit-panel-column-inversion-command-state = "dsi_lp_mode";
		hw,lcdkit-panel-inversion-support = <1>;
		hw,lcdkit-panel-forword-scan-command = [39 01 00 00 00 00 02 E0 01
                        39 01 00 00 00 00 02 37 09
                        39 01 00 00 00 00 02 E0 00];
		hw,lcdkit-panel-forword-scan-command-state = "dsi_lp_mode";
		hw,lcdkit-panel-revert-scan-command = [39 01 00 00 00 00 02 E0 01
                        39 01 00 00 00 00 02 37 05
                        39 01 00 00 00 00 02 E0 00];
		hw,lcdkit-panel-revert-scan-command-state = "dsi_lp_mode";
		hw,lcdkit-panel-scan-support = <1>;
		hw,lcdkit-panel-display-region-support = <0>;
		hw,lcdkit-panel-checksum-support = <0>;
		hw,lcdkit-panel-esd-reg-command = [14 01 00 00 0a 00 01 0a];
		hw,lcdkit-panel-esd-reg-command-state = "dsi_lp_mode";
		hw,lcdkit-panel-esd-value = [1c];
		hw,lcdkit-panel-esd-support = <0>;
		hw,lcdkit-panel-check-reg-command = [14 01 00 00 0a 00 01 0a];
		hw,lcdkit-panel-check-reg-value = [1c];
		hw,lcdkit-panel-check-reg-command-state = "dsi_lp_mode";
		hw,lcdkit-panel-check-reg-support = <1>;
		hw,lcdkit-panel-bl-maxnit-command = [14 01 00 00 00 00 01 db];
		hw,lcdkit-panel-bl-maxnit-command-state = "dsi_lp_mode";
		hw,lcdkit-panel-mipi-detect-support = <0>;
		hw,lcdkit-panel-shutdown-sleep-support = <0>;
		hw,lcdkit-dsi-bpp = <24>;
		hw,lcdkit-panel-cmd-type = <0>;
		hw,lcdkit-pixel-packing = <0>;
		hw,lcdkit-underflow-color = <0x00>;
		hw,lcdkit-border-color = <0>;
		hw,lcdkit-panel-orientation = <0>;
		hw,lcdkit-brightness-max-level = <255>;
		hw,lcdkit-bl-min-level = <4>;
		hw,lcdkit-bl-max-level = <255>;
		hw,lcdkit-interleave-mode = <0>;
		hw,lcdkit-te-using-te-pin;
		hw,lcdkit-h-sync-pulse = <1>;
		hw,lcdkit-bllp-power-mode;
		hw,lcdkit-bllp-eof-power-mode;
		hw,lcdkit-traffic-mode = "burst_mode";
		hw,lcdkit-te-dcs-command = <1>;
		hw,lcdkit-te-pin-select = <1>;
		hw,lcdkit-virtual-channel-id = <0>;
		hw,lcdkit-color-order = "rgb_swap_rgb";
		hw,lcdkit-lane-0-state;
		hw,lcdkit-lane-1-state;
		hw,lcdkit-lane-2-state;
		hw,lcdkit-h-left-border = <0>;
		hw,lcdkit-h-right-border = <0>;
		hw,lcdkit-v-top-border = <0>;
		hw,lcdkit-v-bottom-border = <0>;
		hw,lcdkit-panel-framerate = <60>;
		hw,lcdkit-panel-clockrate = <668360000>;
		hw,lcdkit-panel-timings = [21 1D 06 07 04 03 04 A0
			21 1D 06 07 04 03 04 A0
			21 1D 06 07 04 03 04 A0
			21 1D 06 07 04 03 04 A0
			21 14 06 07 04 03 04 A0];
		hw,lcdkit-panel-timings-phy-v2 = [21 1D 06 07 04 03 04 A0
			21 1D 06 07 04 03 04 A0
			21 1D 06 07 04 03 04 A0
			21 1D 06 07 04 03 04 A0
			21 14 06 07 04 03 04 A0];
		hw,lcdkit-t-clk-pre = <0x27>;
		hw,lcdkit-t-clk-post = <0x0C>;
		hw,lcdkit-tx-eot-append;
		hw,lcdkit-stream = <0>;
		hw,lcdkit-lp11-init;
		hw,lcdkit-mdp-trigger = "none";
		hw,lcdkit-dma-trigger = "trigger_sw";
		hw,lcdkit-bl-pmic-control-type = "bl_ctrl_dcs";
		qcom,panel-supply-entries = <&dsi_panel_pwr_supply>;
		hw,lcdkit-lane-map = "lane_map_0123";
		hw,lcdkit-delay-before-bl = <0>;
		hw,lcdkit-mipi-regulator-mode = <1>;
		hw,lcdkit-bl-en-gpio = <0>;
		hw,lcdkit-delay-af-rst-off = <20>;
		hw,lcdkit-delay-af-blic-init = <0>;
		hw,lcdkit-bl-level-limit-percent = <100>;
		hw,lcdkit-use-second-ic-for-esd = <0>;
		hw,lcdkit-esd-check-num = <3>;
		hw,lcdkit-tp-reset-gpio = <64>;
		hw,lcdkit-panel-tp-suspend-after-lcd-sleep = <1>;
		hw,lcdkit-panel-bl-maxnit = <470>;
		hw,lcdkit-panel-getblmaxnit-type = <1>;
		hw,lcdkit-panel-getblmaxnit-offset = <360>;
		hw,lcdkit-h-back-porch = <76>;
		hw,lcdkit-h-front-porch = <76>;
		hw,lcdkit-h-pulse-width = <20>;
		hw,lcdkit-v-back-porch = <16>;
		hw,lcdkit-v-pulse-width = <2>;
		hw,lcdkit-v-front-porch = <23>;
		hw,lcdkit-h-sync-skew = <0>;
		hw,lcdkit-lcd-type = <0>;
		hw,lcdkit-panel-pt-test-support = <1>;
		hw,lcdkit-bias-power-ctrl-mode = <0x01>;
		hw,lcdkit-bl-dcs-level-trans-mode = <1>;
		hw,lcdkit-bl-dcs-reg              = <0x51>;
		hw,lcdkit-iovcc-power-ctrl-mode = <0x01>;
		hw,lcdkit-vci-power-ctrl-mode = <0x01>;
		hw,lcdkit-id0-gpio = <89>;
		hw,lcdkit-id1-gpio = <66>;
		hw,lcdkit-reset-gpio = <61>;
		hw,lcdkit-te-gpio = <0>;
		hw,lcdkit-vsp-gpio = <0>;
		hw,lcdkit-vsn-gpio = <0>;
		hw,lcdkit-iovcc-gpio = <0>;
		hw,lcdkit-vci-gpio = <0>;
		hw,lcdkit-bl-gpio = <0>;
		hw,lcdkit-iovcc-on-is-need-reset = <0>;
		hw,lcdkit-vsn-on-is-need-reset = <0>;
		hw,lcdkit-lcd-vsp = <6000000>;
		hw,lcdkit-lcd-vsn = <6000000>;
		hw,lcdkit-lcd-rst-first-high = <5>;
		hw,lcdkit-lcd-rst-low = <10>;
		hw,lcdkit-lcd-rst-second-high = <5>;
		hw,lcdkit-delay-af-vci-on = <0>;
		hw,lcdkit-delay-af-iovcc-on = <0>;
		hw,lcdkit-delay-af-bias-on = <0>;
		hw,lcdkit-delay-af-vsp-on = <0>;
		hw,lcdkit-delay-af-vsn-on = <5>;
		hw,lcdkit-delay-af-lp11 = <0>;
		hw,lcdkit-delay-af-tp-reset = <1>;
		hw,lcdkit-delay-af-vsn-off = <0>;
		hw,lcdkit-delay-af-vsp-off = <0>;
		hw,lcdkit-delay-af-bias-off = <0>;
		hw,lcdkit-delay-af-iovcc-off = <1>;
		hw,lcdkit-delay-af-vci-off = <0>;
		hw,lcdkit-panel-off-reset-high = <0>;
		hw,lcdkit-pan-dis-dimming-bf-sleep-in = <0>;
		hw,lcdkit-panel-disable-dimming-command = [15 01 00 00 00 00 02 53 04];
		hw,lcdkit-panel-disable-dimming-command-state = "dsi_lp_mode";
		hw,lcdkit-panel-enable-dimming-command = [15 01 00 00 00 00 02 53 2C];
		hw,lcdkit-panel-enable-dimming-command-state = "dsi_lp_mode";
    };
};
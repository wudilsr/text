/* Copyright (c) 2013, The Linux Foundation. All rights reserved.
 *
 * This program is free software; you can redistribute it and/or modify
 * it under the terms of the GNU General Public License version 2 and
 * only version 2 as published by the Free Software Foundation.
 *
 * This program is distributed in the hope that it will be useful,
 * but WITHOUT ANY WARRANTY; without even the implied warranty of
 * MERCHANTABILITY or FITNESS FOR A PARTICULAR PURPOSE.  See the
 * GNU General Public License for more details.
 */

/*-------------------------------------------------------------------------
 * This file is autogenerated file using gcdb parser. Please do not edit it.
 * Update input XML file to add a new entry or update variable in this file
 * VERSION = 1.1
 *-----------------------------------------------------------------------*/
/ {
	dsi_bkk_al00bhn_vb_txd_inx_nt36525_6p26_720p_video: lcdkit_bkk_al00bhn_vb_txd_inx_nt36525_6p26_720p_video {
		compatible = "txd-inx-nt36525-6p26-720p-video";
		hw,lcdkit-panel-name = "TXD_INX_NT36525 6P26 VIDEO TFT 720 x 1520";
		hw,lcdkit-panel-type = <0x01>;
		hw,lcdkit-panel-xres = <720>;
		hw,lcdkit-panel-yres = <1520>;
		hw,lcdkit-panel-width = <68>;
		hw,lcdkit-panel-height = <144>;
		hw,lcdkit-panel-on-command = [39 01 00 00 00 00 02 FF 20
		39 01 00 00 00 00 02 FB 01
		39 01 00 00 00 00 02 01 55
		39 01 00 00 00 00 02 03 55
		39 01 00 00 00 00 02 05 B1
		39 01 00 00 00 00 02 07 73
		39 01 00 00 00 00 02 08 CB
		39 01 00 00 00 00 02 0E 91
		39 01 00 00 00 00 02 0F 69
		39 01 00 00 00 00 02 69 A9
		39 01 00 00 00 00 02 94 C0
		39 01 00 00 00 00 02 95 13
		39 01 00 00 00 00 02 96 13
		39 01 00 00 00 00 02 FF 24
		39 01 00 00 00 00 02 FB 01
		39 01 00 00 00 00 02 C5 30
		39 01 00 00 00 00 02 93 08
		39 01 00 00 00 00 02 94 06
		39 01 00 00 00 00 02 00 05
		39 01 00 00 00 00 02 01 08
		39 01 00 00 00 00 02 02 00
		39 01 00 00 00 00 02 03 00
		39 01 00 00 00 00 02 0D 18
		39 01 00 00 00 00 02 0E 19
		39 01 00 00 00 00 02 0F 0C
		39 01 00 00 00 00 02 10 0D
		39 01 00 00 00 00 02 11 0E
		39 01 00 00 00 00 02 12 0F
		39 01 00 00 00 00 02 13 10
		39 01 00 00 00 00 02 14 11
		39 01 00 00 00 00 02 15 04
		39 01 00 00 00 00 02 16 05
		39 01 00 00 00 00 02 17 08
		39 01 00 00 00 00 02 18 00
		39 01 00 00 00 00 02 19 00
		39 01 00 00 00 00 02 23 18
		39 01 00 00 00 00 02 24 19
		39 01 00 00 00 00 02 25 0C
		39 01 00 00 00 00 02 26 0D
		39 01 00 00 00 00 02 27 0E
		39 01 00 00 00 00 02 28 0F
		39 01 00 00 00 00 02 29 10
		39 01 00 00 00 00 02 2A 11
		39 01 00 00 00 00 02 2B 04
		39 01 00 00 00 00 02 2F 04
		39 01 00 00 00 00 02 30 32
		39 01 00 00 00 00 02 33 32
		39 01 00 00 00 00 02 34 04
		39 01 00 00 00 00 02 37 44
		39 01 00 00 00 00 02 39 00
		39 01 00 00 00 00 02 3A 10
		39 01 00 00 00 00 02 3B 8F
		39 01 00 00 00 00 02 3D 52
		39 01 00 00 00 00 02 3F 41
		39 01 00 00 00 00 02 40 00
		39 01 00 00 00 00 02 43 41
		39 01 00 00 00 00 02 44 06
		39 01 00 00 00 00 02 47 44
		39 01 00 00 00 00 02 49 00
		39 01 00 00 00 00 02 4A 10
		39 01 00 00 00 00 02 4B 8F
		39 01 00 00 00 00 02 4C 51
		39 01 00 00 00 00 02 4D 12
		39 01 00 00 00 00 02 4E 34
		39 01 00 00 00 00 02 4F 56
		39 01 00 00 00 00 02 51 43
		39 01 00 00 00 00 02 52 21
		39 01 00 00 00 00 02 53 65
		39 01 00 00 00 00 02 55 43
		39 01 00 00 00 00 02 56 46
		39 01 00 00 00 00 02 5A 10
		39 01 00 00 00 00 02 5B 8F
		39 01 00 00 00 00 02 5E 06
		39 01 00 00 00 00 02 5F 00
		39 01 00 00 00 00 02 92 B7
		39 01 00 00 00 00 02 76 00
		39 01 00 00 00 00 02 77 00
		39 01 00 00 00 00 02 78 00
		39 01 00 00 00 00 02 79 00
		39 01 00 00 00 00 02 7A 20
		39 01 00 00 00 00 02 7B 3C
		39 01 00 00 00 00 02 7C 00
		39 01 00 00 00 00 02 7D 00
		39 01 00 00 00 00 02 7E 08
		39 01 00 00 00 00 02 87 02
		39 01 00 00 00 00 02 AB 00
		39 01 00 00 00 00 02 AC 00
		39 01 00 00 00 00 02 AD 00
		39 01 00 00 00 00 02 AF 04
		39 01 00 00 00 00 02 B0 05
		39 01 00 00 00 00 02 B1 B2
		39 01 00 00 00 00 02 60 80
		39 01 00 00 00 00 02 61 7C
		39 01 00 00 00 00 02 64 11
		39 01 00 00 00 00 02 FF 25
		39 01 00 00 00 00 02 FB 01
		39 01 00 00 00 00 02 05 04
		39 01 00 00 00 00 02 07 00
		39 01 00 00 00 00 02 08 01
		39 01 00 00 00 00 02 0A 82
		39 01 00 00 00 00 02 0B 46
		39 01 00 00 00 00 02 0C 01
		39 01 00 00 00 00 02 17 82
		39 01 00 00 00 00 02 18 06
		39 01 00 00 00 00 02 19 0F
		39 01 00 00 00 00 02 1E 00
		39 01 00 00 00 00 02 1F 10
		39 01 00 00 00 00 02 20 8F
		39 01 00 00 00 00 02 23 05
		39 01 00 00 00 00 02 24 B2
		39 01 00 00 00 00 02 25 00
		39 01 00 00 00 00 02 26 10
		39 01 00 00 00 00 02 27 8F
		39 01 00 00 00 00 02 2A 05
		39 01 00 00 00 00 02 2B B2
		39 01 00 00 00 00 02 2D 80
		39 01 00 00 00 00 02 2F 30
		39 01 00 00 00 00 02 30 10
		39 01 00 00 00 00 02 31 00
		39 01 00 00 00 00 02 32 00
		39 01 00 00 00 00 02 33 10
		39 01 00 00 00 00 02 34 8F
		39 01 00 00 00 00 02 37 05
		39 01 00 00 00 00 02 38 B2
		39 01 00 00 00 00 02 40 00
		39 01 00 00 00 00 02 41 80
		39 01 00 00 00 00 02 42 10
		39 01 00 00 00 00 02 43 8F
		39 01 00 00 00 00 02 46 05
		39 01 00 00 00 00 02 47 B2
		39 01 00 00 00 00 02 4A 00
		39 01 00 00 00 00 02 4B 10
		39 01 00 00 00 00 02 4C 8F
		39 01 00 00 00 00 02 4D 10
		39 01 00 00 00 00 02 4E 8F
		39 01 00 00 00 00 02 4F 10
		39 01 00 00 00 00 02 50 8F
		39 01 00 00 00 00 02 53 05
		39 01 00 00 00 00 02 54 B2
		39 01 00 00 00 00 02 55 05
		39 01 00 00 00 00 02 56 B2
		39 01 00 00 00 00 02 58 00
		39 01 00 00 00 00 02 59 00
		39 01 00 00 00 00 02 5A 60
		39 01 00 00 00 00 02 5B 80
		39 01 00 00 00 00 02 5C 00
		39 01 00 00 00 00 02 5D 10
		39 01 00 00 00 00 02 5E 8F
		39 01 00 00 00 00 02 5F 10
		39 01 00 00 00 00 02 60 8F
		39 01 00 00 00 00 02 61 10
		39 01 00 00 00 00 02 62 8F
		39 01 00 00 00 00 02 65 05
		39 01 00 00 00 00 02 66 B2
		39 01 00 00 00 00 02 FF 26
		39 01 00 00 00 00 02 FB 01
		39 01 00 00 00 00 02 00 A0
		39 01 00 00 00 00 02 FF 27
		39 01 00 00 00 00 02 FB 01
		39 01 00 00 00 00 02 96 03
		39 01 00 00 00 00 02 97 15
		39 01 00 00 00 00 02 98 11
		39 01 00 00 00 00 02 99 3F
		39 01 00 00 00 00 02 9B 3F
		39 01 00 00 00 00 02 9D 25
		39 01 00 00 00 00 02 9E 55
		39 01 00 00 00 00 02 9F 05
		39 01 00 00 00 00 02 AD 25
		39 01 00 00 00 00 02 AE 55
		39 01 00 00 00 00 02 AF 05
		39 01 00 00 00 00 02 B3 C6
		39 01 00 00 00 00 02 C0 18
		39 01 00 00 00 00 02 C1 E4
		39 01 00 00 00 00 02 C2 00
		39 01 00 00 00 00 02 C3 00
		39 01 00 00 00 00 02 C4 E4
		39 01 00 00 00 00 02 C5 00
		39 01 00 00 00 00 02 C6 00
		39 01 00 00 00 00 02 C7 03
		39 01 00 00 00 00 02 FF 23
		39 01 00 00 00 00 02 FB 01
		39 01 00 00 00 00 02 00 60
		39 01 00 00 00 00 02 12 AB
		39 01 00 00 00 00 02 15 F5
		39 01 00 00 00 00 02 16 0B
		39 01 00 00 00 00 02 FF 20
		39 01 00 00 00 00 02 FB 01
		39 01 00 00 00 00 11 B0 00 00 00 13 00 32 00 4C 00 62 00 76 00 88 00 98
		39 01 00 00 00 00 11 B1 00 A7 00 D7 00 FD 01 37 01 63 01 A7 01 DE 01 DF
		39 01 00 00 00 00 11 B2 02 10 02 4B 02 71 02 A8 02 CF 02 FA 03 06 03 1B
		39 01 00 00 00 00 0D B3 03 35 03 4B 03 64 03 84 03 B3 03 FF
		39 01 00 00 00 00 11 B4 00 00 00 13 00 32 00 4C 00 62 00 76 00 88 00 98
		39 01 00 00 00 00 11 B5 00 A7 00 D7 00 FD 01 37 01 63 01 A7 01 DE 01 DF
		39 01 00 00 00 00 11 B6 02 10 02 4B 02 71 02 A8 02 CF 02 FA 03 06 03 1B
		39 01 00 00 00 00 0D B7 03 35 03 4B 03 64 03 84 03 B3 03 FF
		39 01 00 00 00 00 11 B8 00 00 00 13 00 32 00 4C 00 62 00 76 00 88 00 98
		39 01 00 00 00 00 11 B9 00 A7 00 D7 00 FD 01 37 01 63 01 A7 01 DE 01 DF
		39 01 00 00 00 00 11 BA 02 10 02 4B 02 71 02 A8 02 CF 02 FA 03 06 03 1B
		39 01 00 00 00 00 0D BB 03 35 03 4B 03 64 03 84 03 B3 03 FF
		39 01 00 00 00 00 02 FF 21
		39 01 00 00 00 00 02 FB 01
		39 01 00 00 00 00 11 B0 00 00 00 13 00 32 00 4C 00 62 00 76 00 88 00 98
		39 01 00 00 00 00 11 B1 00 A7 00 D7 00 FD 01 37 01 63 01 A7 01 DE 01 DF
		39 01 00 00 00 00 11 B2 02 10 02 4B 02 71 02 A8 02 CF 02 FA 03 06 03 1B
		39 01 00 00 00 00 0D B3 03 35 03 4B 03 64 03 84 03 B3 03 FF
		39 01 00 00 00 00 11 B4 00 00 00 13 00 32 00 4C 00 62 00 76 00 88 00 98
		39 01 00 00 00 00 11 B5 00 A7 00 D7 00 FD 01 37 01 63 01 A7 01 DE 01 DF
		39 01 00 00 00 00 11 B6 02 10 02 4B 02 71 02 A8 02 CF 02 FA 03 06 03 1B
		39 01 00 00 00 00 0D B7 03 35 03 4B 03 64 03 84 03 B3 03 FF
		39 01 00 00 00 00 11 B8 00 00 00 13 00 32 00 4C 00 62 00 76 00 88 00 98
		39 01 00 00 00 00 11 B9 00 A7 00 D7 00 FD 01 37 01 63 01 A7 01 DE 01 DF
		39 01 00 00 00 00 11 BA 02 10 02 4B 02 71 02 A8 02 CF 02 FA 03 06 03 1B
		39 01 00 00 00 00 0D BB 03 35 03 4B 03 64 03 84 03 B3 03 FF
		39 01 00 00 00 00 02 FF 10
		39 01 00 00 00 00 02 FB 01
		39 01 00 00 00 00 02 BA 02
		39 01 00 00 00 00 02 35 00
		39 01 00 00 00 00 03 51 00 00
		39 01 00 00 00 00 02 53 2C
		39 01 00 00 00 00 02 55 00
		39 01 00 00 00 00 03 68 02 01
		39 01 00 00 64 00 02 11 00
		39 01 00 00 00 00 02 29 00];
		hw,lcdkit-panel-on-command-state = "dsi_lp_mode";
		hw,lcdkit-panel-display-on-command = [05 01 00 00 96 00 02 11 00
                    05 01 00 00 14 00 02 29 00];
		hw,lcdkit-panel-off-command = [05 01 00 00 14 00 02 28 00
					05 01 00 00 96 00 02 10 00];
		hw,lcdkit-panel-off-command-state = "dsi_lp_mode";
		hw,lcdkit-panel-backlight-command = [39 01 00 00 00 00 03 51 00 00];
		hw,lcdkit-panel-backlight-command-state = "dsi_lp_mode";
		hw,lcdkit-panel-cabc-off-command = [15 01 00 00 0a 00 02 55 00];
		hw,lcdkit-panel-cabc-off-command-state = "dsi_lp_mode";
		hw,lcdkit-panel-cabc-ui-command = [15 01 00 00 0a 00 02 55 01
				  15 01 00 00 0a 00 02 53 2C];
		hw,lcdkit-panel-cabc-ui-command-state = "dsi_lp_mode";
		hw,lcdkit-panel-cabc-still-command = [15 01 00 00 0a 00 02 55 02
				     15 01 00 00 0a 00 02 53 2C];
		hw,lcdkit-panel-cabc-still-command-state = "dsi_lp_mode";
		hw,lcdkit-panel-cabc-moving-command = [15 01 00 00 0a 00 02 55 03
				      15 01 00 00 0a 00 02 53 2C];
		hw,lcdkit-panel-cabc-moving-command-state = "dsi_lp_mode";
		hw,lcdkit-panel-cabc-support = <0>;
		hw,lcdkit-panel-dot-inversion-command = [39 01 00 00 00 00 02 FF 24
			39 01 00 00 00 00 02 FB 01
			39 01 00 00 00 00 02 9B 00
			39 01 00 00 00 00 02 FF 10];
		hw,lcdkit-panel-dot-inversion-command-state = "dsi_lp_mode";
		hw,lcdkit-panel-column-inversion-command = [39 01 00 00 00 00 02 FF 24
			39 01 00 00 00 00 02 FB 01
			39 01 00 00 00 00 02 9B 0F
			39 01 00 00 00 00 02 FF 10];
		hw,lcdkit-panel-column-inversion-command-state = "dsi_lp_mode";
		hw,lcdkit-panel-inversion-support = <1>;
		hw,lcdkit-panel-forword-scan-command = [39 01 00 00 00 00 02 FF 24
			39 01 00 00 00 00 02 FB 01
			39 01 00 00 00 00 02 9D 30
			39 01 00 00 00 00 02 FF 10];
		hw,lcdkit-panel-forword-scan-command-state = "dsi_lp_mode";
		hw,lcdkit-panel-revert-scan-command = [39 01 00 00 00 00 02 FF 24
			39 01 00 00 00 00 02 FB 01
			39 01 00 00 00 00 02 9D 32
			39 01 00 00 00 00 02 FF 10];
		hw,lcdkit-panel-revert-scan-command-state = "dsi_lp_mode";
		hw,lcdkit-panel-scan-support = <1>;
		hw,lcdkit-panel-tp-lcd-reset-sync-support = <0>;
		hw,lcdkit-panel-display-region-support = <0>;
		hw,lcdkit-panel-checksum-support = <0>;
		hw,lcdkit-panel-esd-reg-command = [14 01 00 00 0a 00 01 0a];
		hw,lcdkit-panel-esd-reg-command-state = "dsi_lp_mode";
		hw,lcdkit-panel-esd-value = [9c];
		hw,lcdkit-panel-esd-support = <1>;
		hw,lcdkit-panel-check-reg-command = [14 01 00 00 0a 00 01 0a];
		hw,lcdkit-panel-check-reg-value = [9c];
		hw,lcdkit-panel-check-reg-command-state = "dsi_lp_mode";
		hw,lcdkit-panel-check-reg-support = <1>;
		hw,lcdkit-panel-mipi-detect-support = <0>;
		hw,lcdkit-panel-shutdown-sleep-support = <0>;
		hw,lcdkit-dsi-bpp = <24>;
		hw,lcdkit-panel-cmd-type = <0>;
		hw,lcdkit-pixel-packing = <0>;
		hw,lcdkit-underflow-color = <0x00>;
		hw,lcdkit-border-color = <0>;
		hw,lcdkit-panel-orientation = <0>;
		hw,lcdkit-brightness-max-level = <2047>;
		hw,lcdkit-bl-min-level = <11>;
		hw,lcdkit-bl-max-level = <2047>;
		hw,lcdkit-interleave-mode = <0>;
		hw,lcdkit-down-reset-enable;
		hw,lcdkit-te-using-te-pin;
		hw,lcdkit-h-sync-pulse = <1>;
		hw,lcdkit-bllp-power-mode;
		hw,lcdkit-bllp-eof-power-mode;
		hw,lcdkit-traffic-mode = "burst_mode";
		hw,lcdkit-te-dcs-command = <1>;
		hw,lcdkit-te-pin-select = <1>;
		hw,lcdkit-virtual-channel-id = <0>;
		hw,lcdkit-color-order = "rgb_swap_rgb";
		hw,lcdkit-lane-0-state;
		hw,lcdkit-lane-1-state;
		hw,lcdkit-lane-2-state;
		hw,lcdkit-h-left-border = <0>;
		hw,lcdkit-h-right-border = <0>;
		hw,lcdkit-v-top-border = <0>;
		hw,lcdkit-v-bottom-border = <2>;
		hw,lcdkit-panel-framerate = <60>;
		hw,lcdkit-panel-clockrate = <738350000>;
		hw,lcdkit-panel-timings = [22 1E 07 08 04 03 04 A0
                        22 1E 07 08 04 03 04 A0
                        22 1E 07 08 04 03 04 A0
                        22 1E 07 08 04 03 04 A0
                        22 17 06 07 04 03 04 A0];
		hw,lcdkit-panel-timings-phy-v2 = [22 1E 07 08 04 03 04 A0
                        22 1E 07 08 04 03 04 A0
                        22 1E 07 08 04 03 04 A0
                        22 1E 07 08 04 03 04 A0
                        22 17 06 07 04 03 04 A0];
		hw,lcdkit-t-clk-pre = <0x2A>;
		hw,lcdkit-t-clk-post = <0x0C>;
		hw,lcdkit-tx-eot-append;
		hw,lcdkit-stream = <0>;
		hw,lcdkit-lp11-init;
		hw,lcdkit-mdp-trigger = "none";
		hw,lcdkit-dma-trigger = "trigger_sw";
		hw,lcdkit-bl-pmic-control-type = "bl_ctrl_dcs";
		qcom,panel-supply-entries = <&dsi_panel_pwr_supply>;
		hw,lcdkit-lane-map = "lane_map_0123";
		hw,lcdkit-delay-before-bl = <0>;
		hw,lcdkit-mipi-regulator-mode = <1>;
		hw,lcdkit-bl-en-gpio = <0>;
		hw,lcdkit-delay-af-rst-off = <1>;
		hw,lcdkit-delay-af-blic-init = <0>;
		hw,lcdkit-bl-level-limit-percent = <100>;
		hw,lcdkit-use-second-ic-for-esd = <0>;
		hw,lcdkit-esd-check-num = <3>;
		hw,lcdkit-tp-reset-gpio = <64>;
		hw,lcdkit-panel-tp-suspend-after-lcd-sleep = <1>;
		hw,lcdkit-h-back-porch = <80>;
		hw,lcdkit-h-front-porch = <63>;
		hw,lcdkit-h-pulse-width = <10>;
		hw,lcdkit-v-back-porch = <230>;
		hw,lcdkit-v-pulse-width = <2>;
		hw,lcdkit-v-front-porch = <8>;
		hw,lcdkit-h-sync-skew = <0>;
		hw,lcdkit-lcd-type = <2>;
		hw,lcdkit-panel-pt-test-support = <1>;
		hw,lcdkit-bias-power-ctrl-mode = <0x01>;
		hw,lcdkit-bl-dcs-level-trans-mode = <1>;
		hw,lcdkit-bl-dcs-reg              = <0x51>;
		hw,lcdkit-iovcc-power-ctrl-mode = <0x01>;
		hw,lcdkit-vci-power-ctrl-mode = <0x01>;
		hw,lcdkit-id0-gpio = <89>;
		hw,lcdkit-id1-gpio = <66>;
		hw,lcdkit-reset-gpio = <61>;
		hw,lcdkit-te-gpio = <0>;
		hw,lcdkit-vsp-gpio = <0>;
		hw,lcdkit-vsn-gpio = <0>;
		hw,lcdkit-iovcc-gpio = <0>;
		hw,lcdkit-vci-gpio = <0>;
		hw,lcdkit-bl-gpio = <0>;
		hw,lcdkit-iovcc-on-is-need-reset = <0>;
		hw,lcdkit-vsn-on-is-need-reset = <1>;
		hw,lcdkit-lcd-vsp = <6000000>;
		hw,lcdkit-lcd-vsn = <6000000>;
		hw,lcdkit-lcd-rst-first-high = <1>;
		hw,lcdkit-lcd-rst-low = <1>;
		hw,lcdkit-lcd-rst-second-high = <11>;
		hw,lcdkit-delay-af-vci-on = <0>;
		hw,lcdkit-delay-af-iovcc-on = <2>;
		hw,lcdkit-delay-af-bias-on = <0>;
		hw,lcdkit-delay-af-vsp-on = <1>;
		hw,lcdkit-delay-af-vsn-on = <11>;
		hw,lcdkit-delay-af-lp11 = <0>;
		hw,lcdkit-delay-af-tp-reset = <0>;
		hw,lcdkit-delay-af-vsn-off = <1>;
		hw,lcdkit-delay-af-vsp-off = <1>;
		hw,lcdkit-delay-af-bias-off = <0>;
		hw,lcdkit-delay-af-iovcc-off = <0>;
		hw,lcdkit-delay-af-vci-off = <0>;
		hw,lcdkit-panel-off-reset-high = <0>;
		hw,lcdkit-pan-dis-dimming-bf-sleep-in = <1>;
		hw,lcdkit-panel-disable-dimming-command = [15 01 00 00 00 00 02 53 04];
		hw,lcdkit-panel-disable-dimming-command-state = "dsi_lp_mode";
		hw,lcdkit-panel-enable-dimming-command = [15 01 00 00 00 00 02 53 2C];
		hw,lcdkit-panel-enable-dimming-command-state = "dsi_lp_mode";
    };
};
/*---------------------------------------------------------------------------
 * This file is autogenerated file using huawei LCD parser. Please do not edit it.
 * Update input XML file to add a new entry or update variable in this file
 * Parser location: vendor/huawei/chipset_common/devkit/lcdkit/tools 
 *---------------------------------------------------------------------------*/


#include "dub_al00b_va_djn_cpt_ili9881c_6p26_720p_video.dtsi"
#include "dub_al00b_va_hlt_boe_jd9365d_6p26_720p_video.dtsi"
#include "dub_al00b_va_kd_hsd_hx8394f_6p26_720p_video.dtsi"
#include "dub_al00b_va_txd_inx_ili7807d_6p26_720p_video.dtsi"
/*---------------------------------------------------------------------------
 * This file is autogenerated file using huawei LCD parser. Please do not edit it.
 * Update input XML file to add a new entry or update variable in this file
 * Parser location: vendor/huawei/chipset_common/devkit/lcdkit/tools 
 *---------------------------------------------------------------------------*/


#include "chq_al10b_va_djn_cpt_ili9881c_6p26_720p_video.dtsi"
#include "chq_al10b_va_hsd_hx8394f_5p99_720p_video.dtsi"
#include "chq_al10b_va_mutto_ltps_ili7807_6p26_720p_video.dtsi"
#include "chq_al10b_va_ofilm_hsd_hx8394f_6p26_720p_video.dtsi"
#include "chq_al10b_va_ofilm_inx_hx8399c_6p26_720p_video.dtsi"
#include "chq_al10b_va_txd_ili9881c_5p99_720p_video.dtsi"
#include "chq_al10b_va_txd_inx_ili9881c_6p26_720p_video.dtsi"
/* Copyright (c) 2013, The Linux Foundation. All rights reserved.
 *
 * This program is free software; you can redistribute it and/or modify
 * it under the terms of the GNU General Public License version 2 and
 * only version 2 as published by the Free Software Foundation.
 *
 * This program is distributed in the hope that it will be useful,
 * but WITHOUT ANY WARRANTY; without even the implied warranty of
 * MERCHANTABILITY or FITNESS FOR A PARTICULAR PURPOSE.  See the
 * GNU General Public License for more details.
 */

/*-------------------------------------------------------------------------
 * This file is autogenerated file using gcdb parser. Please do not edit it.
 * Update input XML file to add a new entry or update variable in this file
 * VERSION = 1.1
 *-----------------------------------------------------------------------*/
/ {
	dsi_bkk_al10ahn_vb_hlt_boe_ili9881h_6p26_720p_video: lcdkit_bkk_al10ahn_vb_hlt_boe_ili9881h_6p26_720p_video {
		compatible = "hlt-boe-ili9881c-6p26-720p-video";
		hw,lcdkit-panel-name = "HLT_BOE_ILI9881H 6P26 VIDEO TFT 720 x 1520";
		hw,lcdkit-panel-type = <0x01>;
		hw,lcdkit-panel-xres = <720>;
		hw,lcdkit-panel-yres = <1520>;
		hw,lcdkit-panel-width = <68>;
		hw,lcdkit-panel-height = <144>;
		hw,lcdkit-panel-on-command = [39 01 00 00 00 00 04 FF 98 81 01
		39 01 00 00 00 00 02 00 48
		39 01 00 00 00 00 02 01 33
		39 01 00 00 00 00 02 02 FF
		39 01 00 00 00 00 02 03 05
		39 01 00 00 00 00 02 08 86
		39 01 00 00 00 00 02 09 01
		39 01 00 00 00 00 02 0a 73
		39 01 00 00 00 00 02 0b 00
		39 01 00 00 00 00 02 0c FF
		39 01 00 00 00 00 02 0d FF
		39 01 00 00 00 00 02 0e 05
		39 01 00 00 00 00 02 0f 05
		39 01 00 00 00 00 02 28 48
		39 01 00 00 00 00 02 29 86
		39 01 00 00 00 00 02 2D 60
		39 01 00 00 00 00 02 31 07
		39 01 00 00 00 00 02 32 02
		39 01 00 00 00 00 02 33 00
		39 01 00 00 00 00 02 34 2a
		39 01 00 00 00 00 02 35 09
		39 01 00 00 00 00 02 36 0b
		39 01 00 00 00 00 02 37 15
		39 01 00 00 00 00 02 38 17
		39 01 00 00 00 00 02 39 11
		39 01 00 00 00 00 02 3a 13
		39 01 00 00 00 00 02 3b 06
		39 01 00 00 00 00 02 3c 01
		39 01 00 00 00 00 02 3d 07
		39 01 00 00 00 00 02 3e 07
		39 01 00 00 00 00 02 3f 07
		39 01 00 00 00 00 02 40 07
		39 01 00 00 00 00 02 41 07
		39 01 00 00 00 00 02 42 07
		39 01 00 00 00 00 02 43 07
		39 01 00 00 00 00 02 44 07
		39 01 00 00 00 00 02 45 07
		39 01 00 00 00 00 02 46 07
		39 01 00 00 00 00 02 47 07
		39 01 00 00 00 00 02 48 02
		39 01 00 00 00 00 02 49 00
		39 01 00 00 00 00 02 4a 2A
		39 01 00 00 00 00 02 4b 08
		39 01 00 00 00 00 02 4c 0A
		39 01 00 00 00 00 02 4d 14
		39 01 00 00 00 00 02 4e 16
		39 01 00 00 00 00 02 4f 10
		39 01 00 00 00 00 02 50 12
		39 01 00 00 00 00 02 51 06
		39 01 00 00 00 00 02 52 01
		39 01 00 00 00 00 02 53 07
		39 01 00 00 00 00 02 54 07
		39 01 00 00 00 00 02 55 07
		39 01 00 00 00 00 02 56 07
		39 01 00 00 00 00 02 57 07
		39 01 00 00 00 00 02 58 07
		39 01 00 00 00 00 02 59 07
		39 01 00 00 00 00 02 5a 07
		39 01 00 00 00 00 02 5b 07
		39 01 00 00 00 00 02 5c 07
		39 01 00 00 00 00 02 61 07
		39 01 00 00 00 00 02 62 02
		39 01 00 00 00 00 02 63 00
		39 01 00 00 00 00 02 64 2a
		39 01 00 00 00 00 02 65 0a
		39 01 00 00 00 00 02 66 08
		39 01 00 00 00 00 02 67 12
		39 01 00 00 00 00 02 68 10
		39 01 00 00 00 00 02 69 16
		39 01 00 00 00 00 02 6a 14
		39 01 00 00 00 00 02 6b 22
		39 01 00 00 00 00 02 6c 01
		39 01 00 00 00 00 02 6d 07
		39 01 00 00 00 00 02 6e 07
		39 01 00 00 00 00 02 6f 07
		39 01 00 00 00 00 02 70 07
		39 01 00 00 00 00 02 71 07
		39 01 00 00 00 00 02 72 07
		39 01 00 00 00 00 02 73 07
		39 01 00 00 00 00 02 74 07
		39 01 00 00 00 00 02 75 07
		39 01 00 00 00 00 02 76 07
		39 01 00 00 00 00 02 77 07
		39 01 00 00 00 00 02 78 02
		39 01 00 00 00 00 02 79 00
		39 01 00 00 00 00 02 7a 2a
		39 01 00 00 00 00 02 7b 0b
		39 01 00 00 00 00 02 7c 09
		39 01 00 00 00 00 02 7d 13
		39 01 00 00 00 00 02 7e 11
		39 01 00 00 00 00 02 7f 17
		39 01 00 00 00 00 02 80 15
		39 01 00 00 00 00 02 81 22
		39 01 00 00 00 00 02 82 01
		39 01 00 00 00 00 02 83 07
		39 01 00 00 00 00 02 84 07
		39 01 00 00 00 00 02 85 07
		39 01 00 00 00 00 02 86 07
		39 01 00 00 00 00 02 87 07
		39 01 00 00 00 00 02 88 07
		39 01 00 00 00 00 02 89 07
		39 01 00 00 00 00 02 8a 07
		39 01 00 00 00 00 02 8b 07
		39 01 00 00 00 00 02 8c 07
		39 01 00 00 00 00 02 a0 01
		39 01 00 00 00 00 02 a1 FF
		39 01 00 00 00 00 02 a2 05
		39 01 00 00 00 00 02 a7 9A
		39 01 00 00 00 00 02 a8 9A
		39 01 00 00 00 00 02 a9 14
		39 01 00 00 00 00 02 aa 14
		39 01 00 00 00 00 02 b0 34
		39 01 00 00 00 00 02 b2 04
		39 01 00 00 00 00 02 b9 00
		39 01 00 00 00 00 02 ba 01
		39 01 00 00 00 00 02 c1 10
		39 01 00 00 00 00 02 d0 01
		39 01 00 00 00 00 02 d1 00
		39 01 00 00 00 00 02 e2 00
		39 01 00 00 00 00 02 e6 42
		39 01 00 00 00 00 02 ea 0F
		39 01 00 00 00 00 02 B0 34
		39 01 00 00 00 00 02 B2 04
		39 01 00 00 00 00 02 E7 54
		39 01 00 00 00 00 04 FF 98 81 02
		39 01 00 00 00 00 02 40 48
		39 01 00 00 00 00 02 70 35
		39 01 00 00 00 00 02 73 09
		39 01 00 00 00 00 02 79 f5
		39 01 00 00 00 00 02 4B 5A
		39 01 00 00 00 00 02 4D 4E
		39 01 00 00 00 00 02 4E 00
		39 01 00 00 00 00 02 19 38
		39 01 00 00 00 00 02 1A 38
		39 01 00 00 00 00 02 52 48
		39 01 00 00 00 00 02 57 48
		39 01 00 00 00 00 04 FF 98 81 05
		39 01 00 00 00 00 02 03 01
		39 01 00 00 00 00 02 04 35
		39 01 00 00 00 00 02 50 1F
		39 01 00 00 00 00 02 58 63
		39 01 00 00 00 00 02 63 97
		39 01 00 00 00 00 02 64 97
		39 01 00 00 00 00 02 68 65
		39 01 00 00 00 00 02 69 6B
		39 01 00 00 00 00 02 6A F1
		39 01 00 00 00 00 02 6B E3
		39 01 00 00 00 00 04 FF 98 81 06
		39 01 00 00 00 00 02 DD 10
		39 01 00 00 00 00 02 11 03
		39 01 00 00 00 00 02 13 97
		39 01 00 00 00 00 02 14 41
		39 01 00 00 00 00 02 15 44
		39 01 00 00 00 00 02 16 41
		39 01 00 00 00 00 02 17 48
		39 01 00 00 00 00 02 18 3B
		39 01 00 00 00 00 02 D6 85
		39 01 00 00 00 00 02 27 20
		39 01 00 00 00 00 02 28 20
		39 01 00 00 00 00 02 2E 01
		39 01 00 00 00 00 02 C0 F7
		39 01 00 00 00 00 02 C1 02
		39 01 00 00 00 00 02 C2 04
		39 01 00 00 00 00 02 48 0F
		39 01 00 00 00 00 02 4D 80
		39 01 00 00 00 00 02 4E 40
		39 01 00 00 00 00 02 C7 05
		39 01 00 00 00 00 02 7C 40
		39 01 00 00 00 00 04 FF 98 81 07
		39 01 00 00 00 00 02 0F 02
		39 01 00 00 00 00 04 FF 98 81 08
		39 01 00 00 00 00 1C E0 00 24 45 60 8B 50 B3 D7 04 2C 95 6E A6 D9 08 AA 3C 7B A2 D2 FE F9 2B 67 99 03 EC
		39 01 00 00 00 00 1C E1 00 24 45 60 8B 50 B3 D7 04 2C 95 6E A6 D9 08 AA 3C 7B A2 D2 FE F9 2B 67 99 03 EC
		39 01 00 00 00 00 04 FF 98 81 0E
		39 01 00 00 00 00 02 00 A1
		39 01 00 00 00 00 02 01 28
		39 01 00 00 00 00 02 02 10
		39 01 00 00 00 00 02 13 10
		39 01 00 00 00 00 02 41 00
		39 01 00 00 00 00 02 43 60
		39 01 00 00 00 00 02 20 07
		39 01 00 00 00 00 02 29 BE
		39 01 00 00 00 00 02 45 0A
		39 01 00 00 00 00 02 46 23
		39 01 00 00 00 00 02 27 80
		39 01 00 00 00 00 02 2D 95
		39 01 00 00 00 00 02 2E 87
		39 01 00 00 00 00 02 2F 87
		39 01 00 00 00 00 02 40 07
		39 01 00 00 00 00 02 49 BE
		39 01 00 00 00 00 02 4D 95
		39 01 00 00 00 00 02 C0 11
		39 01 00 00 00 00 02 C1 80
		39 01 00 00 00 00 02 C2 08
		39 01 00 00 00 00 02 C3 01
		39 01 00 00 00 00 02 C4 44
		39 01 00 00 00 00 02 C5 44
		39 01 00 00 00 00 02 C6 44
		39 01 00 00 00 00 02 C7 40
		39 01 00 00 00 00 02 D0 35
		39 01 00 00 00 00 02 D1 02
		39 01 00 00 00 00 02 D2 00
		39 01 00 00 00 00 02 D3 95
		39 01 00 00 00 00 02 D4 95
		39 01 00 00 00 00 02 D5 95
		39 01 00 00 00 00 02 D6 95
		39 01 00 00 00 00 02 D7 95
		39 01 00 00 00 00 02 D8 95
		39 01 00 00 00 00 02 D9 98
		39 01 00 00 00 00 02 DA 11
		39 01 00 00 00 00 02 DB 44
		39 01 00 00 00 00 02 DC 44
		39 01 00 00 00 00 02 DD 44
		39 01 00 00 00 00 02 E1 08
		39 01 00 00 00 00 02 E2 19
		39 01 00 00 00 00 02 E3 10
		39 01 00 00 00 00 02 05 03
		39 01 00 00 00 00 02 07 21
		39 01 00 00 00 00 02 4B 19
		39 01 00 00 00 00 04 FF 98 81 0C
		39 01 00 00 00 00 02 00 10
		39 01 00 00 00 00 02 01 0C
		39 01 00 00 00 00 02 02 10
		39 01 00 00 00 00 02 03 0E
		39 01 00 00 00 00 02 04 10
		39 01 00 00 00 00 02 05 0D
		39 01 00 00 00 00 02 06 10
		39 01 00 00 00 00 02 07 10
		39 01 00 00 00 00 02 08 10
		39 01 00 00 00 00 02 09 0F
		39 01 00 00 00 00 02 0A 11
		39 01 00 00 00 00 02 0B 12
		39 01 00 00 00 00 02 0C 11
		39 01 00 00 00 00 02 0D 11
		39 01 00 00 00 00 02 0E 11
		39 01 00 00 00 00 02 0F 14
		39 01 00 00 00 00 02 10 11
		39 01 00 00 00 00 02 11 16
		39 01 00 00 00 00 02 12 11
		39 01 00 00 00 00 02 13 15
		39 01 00 00 00 00 02 14 11
		39 01 00 00 00 00 02 15 13
		39 01 00 00 00 00 02 16 11
		39 01 00 00 00 00 02 17 17
		39 01 00 00 00 00 02 18 11
		39 01 00 00 00 00 02 19 19
		39 01 00 00 00 00 02 1A 11
		39 01 00 00 00 00 02 1B 18
		39 01 00 00 00 00 02 1C 11
		39 01 00 00 00 00 02 1D 1A
		39 01 00 00 00 00 02 1E 12
		39 01 00 00 00 00 02 1F 1C
		39 01 00 00 00 00 02 20 12
		39 01 00 00 00 00 02 21 1B
		39 01 00 00 00 00 02 22 12
		39 01 00 00 00 00 02 23 1D
		39 01 00 00 00 00 02 24 12
		39 01 00 00 00 00 02 25 21
		39 01 00 00 00 00 02 26 12
		39 01 00 00 00 00 02 27 1F
		39 01 00 00 00 00 02 28 12
		39 01 00 00 00 00 02 29 1E
		39 01 00 00 00 00 02 2A 12
		39 01 00 00 00 00 02 2B 20
		39 01 00 00 00 00 02 2C 12
		39 01 00 00 00 00 02 2D 22
		39 01 00 00 00 00 02 2E 13
		39 01 00 00 00 00 02 2F 24
		39 01 00 00 00 00 02 30 13
		39 01 00 00 00 00 02 31 23
		39 01 00 00 00 00 02 32 13
		39 01 00 00 00 00 02 33 25
		39 01 00 00 00 00 04 FF 98 81 06
		39 01 00 00 00 00 02 06 C4
		39 01 00 00 00 00 02 83 00
		39 01 00 00 00 00 02 84 00
		39 01 00 00 00 00 04 FF 98 81 04
		39 01 00 00 00 00 02 01 85
		39 01 00 00 00 00 02 87 0E
		39 01 00 00 00 00 04 FF 98 81 03
		39 01 00 00 00 00 02 83 30
		39 01 00 00 00 00 02 84 00
		39 01 00 00 00 00 04 FF 98 81 00
		39 01 00 00 00 00 03 51 00 00
		39 01 00 00 00 00 02 53 2C
		39 01 00 00 00 00 02 55 00
		39 01 00 00 00 00 03 68 02 01
		39 01 00 00 40 00 02 11 00
		39 01 00 00 00 00 02 29 00
		39 01 00 00 00 00 02 35 00];
		hw,lcdkit-panel-on-command-state = "dsi_lp_mode";
		hw,lcdkit-panel-display-on-command = [05 01 00 00 96 00 02 11 00
                    05 01 00 00 14 00 02 29 00];
		hw,lcdkit-panel-off-command = [05 01 00 00 14 00 02 28 00
					05 01 00 00 96 00 02 10 00];
		hw,lcdkit-panel-off-command-state = "dsi_lp_mode";
		hw,lcdkit-panel-backlight-command = [39 01 00 00 00 00 03 51 0F FF];
		hw,lcdkit-panel-backlight-command-state = "dsi_lp_mode";
		hw,lcdkit-panel-cabc-off-command = [15 01 00 00 0a 00 02 55 00];
		hw,lcdkit-panel-cabc-off-command-state = "dsi_lp_mode";
		hw,lcdkit-panel-cabc-ui-command = [15 01 00 00 0a 00 02 55 01
				  15 01 00 00 0a 00 02 53 2C];
		hw,lcdkit-panel-cabc-ui-command-state = "dsi_lp_mode";
		hw,lcdkit-panel-cabc-still-command = [15 01 00 00 0a 00 02 55 02
				     15 01 00 00 0a 00 02 53 2C];
		hw,lcdkit-panel-cabc-still-command-state = "dsi_lp_mode";
		hw,lcdkit-panel-cabc-moving-command = [15 01 00 00 0a 00 02 55 03
				      15 01 00 00 0a 00 02 53 2C];
		hw,lcdkit-panel-cabc-moving-command-state = "dsi_lp_mode";
		hw,lcdkit-panel-cabc-support = <0>;
		hw,lcdkit-panel-dot-inversion-command = [39 01 00 00 00 00 04 FF 98 81 02
			39 01 00 00 00 00 02 44 00
			39 01 00 00 00 00 04 FF 98 81 00];
		hw,lcdkit-panel-dot-inversion-command-state = "dsi_lp_mode";
		hw,lcdkit-panel-column-inversion-command = [39 01 00 00 00 00 04 FF 98 81 02
			39 01 00 00 00 00 02 44 08
			39 01 00 00 00 00 04 FF 98 81 00];
		hw,lcdkit-panel-column-inversion-command-state = "dsi_lp_mode";
		hw,lcdkit-panel-inversion-support = <1>;
		hw,lcdkit-panel-forword-scan-command = [39 01 00 00 00 00 04 FF 98 81 00
			39 01 00 00 00 00 02 36 00];
		hw,lcdkit-panel-forword-scan-command-state = "dsi_lp_mode";
		hw,lcdkit-panel-revert-scan-command = [39 01 00 00 00 00 04 FF 98 81 00
			39 01 00 00 00 00 02 36 03];
		hw,lcdkit-panel-revert-scan-command-state = "dsi_lp_mode";
		hw,lcdkit-panel-scan-support = <1>;
		hw,lcdkit-panel-tp-lcd-reset-sync-support = <1>;
		hw,lcdkit-panel-display-region-support = <0>;
		hw,lcdkit-panel-checksum-support = <0>;
		hw,lcdkit-panel-esd-reg-command = [14 01 00 00 0a 00 01 0a];
		hw,lcdkit-panel-esd-reg-command-state = "dsi_lp_mode";
		hw,lcdkit-panel-esd-value = [9c];
		hw,lcdkit-panel-esd-support = <1>;
		hw,lcdkit-panel-check-reg-command = [14 01 00 00 0a 00 01 0a];
		hw,lcdkit-panel-check-reg-value = [9c];
		hw,lcdkit-panel-check-reg-command-state = "dsi_lp_mode";
		hw,lcdkit-panel-check-reg-support = <1>;
		hw,lcdkit-panel-mipi-detect-support = <0>;
		hw,lcdkit-panel-shutdown-sleep-support = <0>;
		hw,lcdkit-dsi-bpp = <24>;
		hw,lcdkit-panel-cmd-type = <0>;
		hw,lcdkit-pixel-packing = <0>;
		hw,lcdkit-underflow-color = <0x00>;
		hw,lcdkit-border-color = <0>;
		hw,lcdkit-panel-orientation = <0>;
		hw,lcdkit-brightness-max-level = <2047>;
		hw,lcdkit-bl-min-level = <11>;
		hw,lcdkit-bl-max-level = <2047>;
		hw,lcdkit-interleave-mode = <0>;
		hw,lcdkit-down-reset-enable;
		hw,lcdkit-te-using-te-pin;
		hw,lcdkit-h-sync-pulse = <1>;
		hw,lcdkit-bllp-power-mode;
		hw,lcdkit-bllp-eof-power-mode;
		hw,lcdkit-traffic-mode = "burst_mode";
		hw,lcdkit-te-dcs-command = <1>;
		hw,lcdkit-te-pin-select = <1>;
		hw,lcdkit-virtual-channel-id = <0>;
		hw,lcdkit-color-order = "rgb_swap_rgb";
		hw,lcdkit-lane-0-state;
		hw,lcdkit-lane-1-state;
		hw,lcdkit-lane-2-state;
		hw,lcdkit-h-left-border = <0>;
		hw,lcdkit-h-right-border = <0>;
		hw,lcdkit-v-top-border = <0>;
		hw,lcdkit-v-bottom-border = <0>;
		hw,lcdkit-panel-framerate = <60>;
		hw,lcdkit-panel-clockrate = <683860000>;
		hw,lcdkit-panel-timings = [21 1E 06 07 04 03 04 A0
                        21 1E 06 07 04 03 04 A0
                        21 1E 06 07 04 03 04 A0
                        21 1E 06 07 04 03 04 A0
                        21 15 06 07 04 03 04 A0];
		hw,lcdkit-panel-timings-phy-v2 = [21 1E 06 07 04 03 04 A0
			21 1E 06 07 04 03 04 A0
			21 1E 06 07 04 03 04 A0
			21 1E 06 07 04 03 04 A0
			21 15 06 07 04 03 04 A0];
		hw,lcdkit-t-clk-pre = <0x28>;
		hw,lcdkit-t-clk-post = <0x0C>;
		hw,lcdkit-tx-eot-append;
		hw,lcdkit-stream = <0>;
		hw,lcdkit-lp11-init;
		hw,lcdkit-mdp-trigger = "none";
		hw,lcdkit-dma-trigger = "trigger_sw";
		hw,lcdkit-bl-pmic-control-type = "bl_ctrl_dcs";
		qcom,panel-supply-entries = <&dsi_panel_pwr_supply>;
		hw,lcdkit-lane-map = "lane_map_0123";
		hw,lcdkit-delay-before-bl = <0>;
		hw,lcdkit-mipi-regulator-mode = <1>;
		hw,lcdkit-bl-en-gpio = <0>;
		hw,lcdkit-delay-af-rst-off = <20>;
		hw,lcdkit-delay-af-blic-init = <0>;
		hw,lcdkit-bl-level-limit-percent = <100>;
		hw,lcdkit-use-second-ic-for-esd = <0>;
		hw,lcdkit-esd-check-num = <3>;
		hw,lcdkit-tp-reset-gpio = <64>;
		hw,lcdkit-panel-tp-suspend-after-lcd-sleep = <1>;
		hw,lcdkit-h-back-porch = <88>;
		hw,lcdkit-h-front-porch = <88>;
		hw,lcdkit-h-pulse-width = <8>;
		hw,lcdkit-v-back-porch = <12>;
		hw,lcdkit-v-pulse-width = <4>;
		hw,lcdkit-v-front-porch = <40>;
		hw,lcdkit-h-sync-skew = <0>;
		hw,lcdkit-lcd-type = <2>;
		hw,lcdkit-panel-pt-test-support = <1>;
		hw,lcdkit-bias-power-ctrl-mode = <0x01>;
		hw,lcdkit-bl-dcs-level-trans-mode = <0>;
		hw,lcdkit-bl-dcs-reg              = <0x51>;
		hw,lcdkit-iovcc-power-ctrl-mode = <0x01>;
		hw,lcdkit-vci-power-ctrl-mode = <0x01>;
		hw,lcdkit-id0-gpio = <89>;
		hw,lcdkit-id1-gpio = <66>;
		hw,lcdkit-reset-gpio = <61>;
		hw,lcdkit-te-gpio = <0>;
		hw,lcdkit-vsp-gpio = <0>;
		hw,lcdkit-vsn-gpio = <0>;
		hw,lcdkit-iovcc-gpio = <0>;
		hw,lcdkit-vci-gpio = <0>;
		hw,lcdkit-bl-gpio = <0>;
		hw,lcdkit-iovcc-on-is-need-reset = <0>;
		hw,lcdkit-vsn-on-is-need-reset = <0>;
		hw,lcdkit-lcd-vsp = <6000000>;
		hw,lcdkit-lcd-vsn = <6000000>;
		hw,lcdkit-lcd-rst-first-high = <1>;
		hw,lcdkit-lcd-rst-low = <1>;
		hw,lcdkit-lcd-rst-second-high = <40>;
		hw,lcdkit-delay-af-vci-on = <0>;
		hw,lcdkit-delay-af-iovcc-on = <2>;
		hw,lcdkit-delay-af-bias-on = <0>;
		hw,lcdkit-delay-af-vsp-on = <1>;
		hw,lcdkit-delay-af-vsn-on = <1>;
		hw,lcdkit-delay-af-lp11 = <0>;
		hw,lcdkit-delay-af-tp-reset = <0>;
		hw,lcdkit-delay-af-vsn-off = <2>;
		hw,lcdkit-delay-af-vsp-off = <5>;
		hw,lcdkit-delay-af-bias-off = <0>;
		hw,lcdkit-delay-af-iovcc-off = <0>;
		hw,lcdkit-delay-af-vci-off = <0>;
		hw,lcdkit-panel-off-reset-high = <0>;
		hw,lcdkit-pan-dis-dimming-bf-sleep-in = <1>;
		hw,lcdkit-panel-disable-dimming-command = [15 01 00 00 00 00 02 53 04];
		hw,lcdkit-panel-disable-dimming-command-state = "dsi_lp_mode";
		hw,lcdkit-panel-enable-dimming-command = [15 01 00 00 00 00 02 53 2C];
		hw,lcdkit-panel-enable-dimming-command-state = "dsi_lp_mode";
    };
};
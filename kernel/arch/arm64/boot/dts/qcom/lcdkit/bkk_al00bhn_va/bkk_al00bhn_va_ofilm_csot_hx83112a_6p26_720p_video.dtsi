/* Copyright (c) 2013, The Linux Foundation. All rights reserved.
 *
 * This program is free software; you can redistribute it and/or modify
 * it under the terms of the GNU General Public License version 2 and
 * only version 2 as published by the Free Software Foundation.
 *
 * This program is distributed in the hope that it will be useful,
 * but WITHOUT ANY WARRANTY; without even the implied warranty of
 * MERCHANTABILITY or FITNESS FOR A PARTICULAR PURPOSE.  See the
 * GNU General Public License for more details.
 */

/*-------------------------------------------------------------------------
 * This file is autogenerated file using gcdb parser. Please do not edit it.
 * Update input XML file to add a new entry or update variable in this file
 * VERSION = 1.1
 *-----------------------------------------------------------------------*/
/ {
	dsi_bkk_al00bhn_va_ofilm_csot_hx83112a_6p26_720p_video: lcdkit_bkk_al00bhn_va_ofilm_csot_hx83112a_6p26_720p_video {
		compatible = "ofilm-csot-hx83112a-6p26-720p-video";
		hw,lcdkit-panel-name = "OFILM-CSOT-HX83112A 6P26 VIDEO TFT 720 x 1520";
		hw,lcdkit-panel-type = <0x01>;
		hw,lcdkit-panel-xres = <720>;
		hw,lcdkit-panel-yres = <1520>;
		hw,lcdkit-panel-width = <68>;
		hw,lcdkit-panel-height = <144>;
		hw,lcdkit-panel-on-command = [39 01 00 00 00 00 04 B9 83 11 2A
		39 01 00 00 00 00 02 BA 72
		39 01 00 00 00 00 09 B1 08 2D 2D 82 82 4F 4A AA
		39 01 00 00 00 00 02 BD 01
		39 01 00 00 00 00 04 CB 25 11 01
		39 01 00 00 00 00 02 BD 00
		39 01 00 00 00 00 0C B2 00 02 00 52 F0 00 08 26 23 12 14
		39 01 00 00 00 00 03 D2 2D 2D
		39 01 00 00 00 00 1C B4 08 E0 08 EF 08 EF 0A EF 08 E0 08 E0 00 FF 00 FF 06 00 17 16 00 3A 08 0A 0D 00 88
		39 01 00 00 00 00 04 B6 8B 8B E3
		39 01 00 00 00 00 05 C0 23 23 00 44
		39 01 00 00 00 00 2C D3 C0 00 00 00 00 01 00 08 08 03 03 00 08 07 07 07 07 32 10 06 00 06 32 10 07 00 07 32 10 07 00 07 00 00 00 00 00 00 00 09 05 FC 00
		39 01 00 00 00 00 02 BD 01
		39 01 00 00 00 00 09 D3 00 00 19 00 00 0A 04 81
		39 01 00 00 00 00 02 BD 00
		39 01 00 00 00 00 31 D5 18 18 18 18 18 18 18 18 18 18 18 18 18 18 18 18 18 18 18 18 C0 C0 C0 18 2F 2F 30 30 31 31 40 40 18 18 40 40 25 24 02 01 00 03 01 00 03 02 19 19
		39 01 00 00 00 00 31 D6 18 18 18 18 18 18 18 18 18 18 18 18 18 18 18 18 18 18 18 18 40 40 18 40 2F 2F 30 30 31 31 40 40 18 18 19 19 24 25 01 02 03 00 02 03 00 01 40 40
		39 01 00 00 00 00 19 D8 00 00 00 00 00 00 00 00 00 00 00 00 00 00 00 00 00 00 00 00 00 00 00 00
		39 01 00 00 00 00 02 BD 01
		39 01 00 00 00 00 19 D8 00 00 00 00 00 00 00 00 00 00 00 00 00 00 00 00 00 00 00 00 00 00 00 00
		39 01 00 00 00 00 02 BD 02
		39 01 00 00 00 00 0D D8 AA AA AA FE EE AA AA AA AA FE EE AA
		39 01 00 00 00 00 02 BD 03
		39 01 00 00 00 00 19 D8 AA AA AA FF AE AA AA AA AA FF AE AA AA AA AA FE EE AA AA AA AA FE EE AA
		39 01 00 00 00 00 02 BD 00
		39 01 00 00 00 00 18 E7 0E 0E 1E 7B 1D 7B 00 32 02 02 00 00 02 02 02 05 14 14 32 B9 23 B9 08
		39 01 00 00 00 00 02 BD 01
		39 01 00 00 00 00 09 E7 02 00 6C 01 6D 0D 6C 0E
		39 01 00 00 00 00 02 BD 02
		39 01 00 00 00 00 1D E7 00 00 08 00 01 00 00 00 00 00 00 00 00 00 00 00 00 00 00 00 00 00 04 00 00 00 00 02
		39 01 00 00 00 00 0A B4 00 92 12 11 88 12 12 00 53
		39 01 00 00 00 00 02 BD 00
		39 01 00 00 00 00 07 C7 70 00 04 E0 33 00
		39 01 00 00 00 00 02 E9 C3
		39 01 00 00 00 00 03 CB D2 47
		39 01 00 00 00 00 02 E9 3F
		39 01 00 00 00 00 02 CC 08
		39 01 00 00 00 00 02 C1 01
		39 01 00 00 00 00 02 BD 01
		39 01 00 00 00 00 3A C1 FF FC F9 F4 F0 EC E7 DE D9 D4 D0 CA C4 BF BA B5 AF AA A4 9A 90 86 7D 74 6B 62 5B 53 4B 44 3E 37 30 29 22 1C 16 11 0B 06 04 02 02 01 00 37 5D A1 FC 8C 15 B0 34 1E DA 71 00
		39 01 00 00 00 00 02 BD 02
		39 01 00 00 00 00 3A C1 FF FC F9 F4 F0 EC E7 DE D9 D4 D0 CA C4 BF BA B5 AF AA A4 9A 90 86 7D 74 6B 62 5B 53 4B 44 3E 37 30 29 22 1C 16 11 0B 06 04 02 02 01 00 37 5D A1 FC 8C 15 B0 34 1E DA 71 00
		39 01 00 00 00 00 02 BD 03
		39 01 00 00 00 00 3A C1 FF FC F9 F4 F0 EC E7 DE D9 D4 D0 CA C4 BF BA B5 AF AA A4 9A 90 86 7D 74 6B 62 5B 53 4B 44 3E 37 30 29 22 1C 16 11 0B 06 04 02 02 01 00 37 5D A1 FC 8C 15 B0 34 1E DA 71 00
		39 01 00 00 00 00 02 BD 00
		39 01 00 00 00 00 05 C9 04 06 E0 01
		39 01 00 00 00 00 03 51 00 00
		39 01 00 00 00 00 03 5E 00 04
		39 01 00 00 00 00 02 53 2c
		39 01 00 00 00 00 02 55 00
		39 01 00 00 50 00 02 11 00
		39 01 00 00 00 00 02 29 00];
		hw,lcdkit-panel-on-command-state = "dsi_lp_mode";
		hw,lcdkit-panel-display-on-command = [05 01 00 00 96 00 02 11 00
                    05 01 00 00 14 00 02 29 00];
		hw,lcdkit-panel-off-command = [05 01 00 00 32 00 02 28 00
					39 01 00 00 00 00 04 B9 83 11 2A
					39 01 00 00 00 00 03 D9 00 FF
					05 01 00 00 96 00 02 10 00];
		hw,lcdkit-panel-off-command-state = "dsi_lp_mode";
		hw,lcdkit-pt-panel-off-command = [05 01 00 00 32 00 02 28 00
                                        39 01 00 00 00 00 04 B9 83 11 2A
                                        39 01 00 00 00 00 03 D9 00 01
                                        05 01 00 00 96 00 02 10 00];
		hw,lcdkit-pt-panel-off-command-state = "dsi_lp_mode";
		hw,lcdkit-panel-backlight-command = [39 01 00 00 00 00 03 51 00 00];
		hw,lcdkit-panel-backlight-command-state = "dsi_lp_mode";
		hw,lcdkit-panel-cabc-off-command = [15 01 00 00 0a 00 02 55 00];
		hw,lcdkit-panel-cabc-off-command-state = "dsi_lp_mode";
		hw,lcdkit-panel-cabc-ui-command = [15 01 00 00 0a 00 02 55 01
				  15 01 00 00 0a 00 02 53 2C];
		hw,lcdkit-panel-cabc-ui-command-state = "dsi_lp_mode";
		hw,lcdkit-panel-cabc-still-command = [15 01 00 00 0a 00 02 55 02
				     15 01 00 00 0a 00 02 53 2C];
		hw,lcdkit-panel-cabc-still-command-state = "dsi_lp_mode";
		hw,lcdkit-panel-cabc-moving-command = [15 01 00 00 0a 00 02 55 03
				      15 01 00 00 0a 00 02 53 2C];
		hw,lcdkit-panel-cabc-moving-command-state = "dsi_lp_mode";
		hw,lcdkit-panel-cabc-support = <0>;
		hw,lcdkit-panel-dot-inversion-command = [39 01 00 00 00 00 0C B2 01 02 00 52 F0 00 08 26 23 12 14];
		hw,lcdkit-panel-dot-inversion-command-state = "dsi_lp_mode";
		hw,lcdkit-panel-column-inversion-command = [39 01 00 00 00 00 0C B2 00 02 00 52 F0 00 08 26 23 12 14];
		hw,lcdkit-panel-column-inversion-command-state = "dsi_lp_mode";
		hw,lcdkit-panel-inversion-support = <1>;
		hw,lcdkit-panel-forword-scan-command = [39 01 00 00 00 00 02 CC 08];
		hw,lcdkit-panel-forword-scan-command-state = "dsi_lp_mode";
		hw,lcdkit-panel-revert-scan-command = [39 01 00 00 00 00 02 CC 04];
		hw,lcdkit-panel-revert-scan-command-state = "dsi_lp_mode";
		hw,lcdkit-panel-scan-support = <1>;
		hw,lcdkit-panel-tp-lcd-reset-sync-support = <1>;
		hw,lcdkit-panel-display-region-support = <0>;
		hw,lcdkit-panel-checksum-support = <0>;
		hw,lcdkit-panel-esd-reg-command = [14 01 00 00 0a 00 01 0a];
		hw,lcdkit-panel-esd-reg-command-state = "dsi_lp_mode";
		hw,lcdkit-panel-esd-value = [9d];
		hw,lcdkit-panel-esd-support = <0>;
		hw,lcdkit-panel-check-reg-command = [14 01 00 00 0a 00 01 0a];
		hw,lcdkit-panel-check-reg-value = [9d];
		hw,lcdkit-panel-check-reg-command-state = "dsi_lp_mode";
		hw,lcdkit-panel-check-reg-support = <1>;
		hw,lcdkit-panel-mipi-detect-support = <0>;
		hw,lcdkit-panel-shutdown-sleep-support = <1>;
		hw,lcdkit-dsi-bpp = <24>;
		hw,lcdkit-panel-cmd-type = <0>;
		hw,lcdkit-pixel-packing = <0>;
		hw,lcdkit-underflow-color = <0x00>;
		hw,lcdkit-border-color = <0>;
		hw,lcdkit-panel-orientation = <0>;
		hw,lcdkit-brightness-max-level = <2047>;
		hw,lcdkit-bl-min-level = <11>;
		hw,lcdkit-bl-max-level = <2047>;
		hw,lcdkit-interleave-mode = <0>;
		hw,lcdkit-down-reset-enable;
		hw,lcdkit-lcd-reset-low-before-resume;
		hw,lcdkit-te-using-te-pin;
		hw,lcdkit-h-sync-pulse = <1>;
		hw,lcdkit-bllp-power-mode;
		hw,lcdkit-bllp-eof-power-mode;
		hw,lcdkit-traffic-mode = "burst_mode";
		hw,lcdkit-te-dcs-command = <1>;
		hw,lcdkit-te-pin-select = <1>;
		hw,lcdkit-virtual-channel-id = <0>;
		hw,lcdkit-color-order = "rgb_swap_rgb";
		hw,lcdkit-lane-0-state;
		hw,lcdkit-lane-1-state;
		hw,lcdkit-lane-2-state;
		hw,lcdkit-h-left-border = <0>;
		hw,lcdkit-h-right-border = <0>;
		hw,lcdkit-v-top-border = <0>;
		hw,lcdkit-v-bottom-border = <0>;
		hw,lcdkit-panel-framerate = <60>;
		hw,lcdkit-panel-clockrate = <684270000>;
		hw,lcdkit-panel-timings = [21 1E 06 08 04 03 04 A0
			21 1E 06 08 04 03 04 A0
			21 1E 06 08 04 03 04 A0
			21 1E 06 08 04 03 04 A0
			21 15 06 07 04 03 04 A0];
		hw,lcdkit-panel-timings-phy-v2 = [21 1E 06 08 04 03 04 A0
			21 1E 06 08 04 03 04 A0
			21 1E 06 08 04 03 04 A0
			21 1E 06 08 04 03 04 A0
			21 15 06 07 04 03 04 A0];
		hw,lcdkit-t-clk-pre = <0x26>;
		hw,lcdkit-t-clk-post = <0x0C>;
		hw,lcdkit-tx-eot-append;
		hw,lcdkit-stream = <0>;
		hw,lcdkit-lp11-init;
		hw,lcdkit-mdp-trigger = "none";
		hw,lcdkit-dma-trigger = "trigger_sw";
		hw,lcdkit-bl-pmic-control-type = "bl_ctrl_dcs";
		qcom,panel-supply-entries = <&dsi_panel_pwr_supply>;
		hw,lcdkit-lane-map = "lane_map_0123";
		hw,lcdkit-delay-before-bl = <0>;
		hw,lcdkit-mipi-regulator-mode = <1>;
		hw,lcdkit-bl-en-gpio = <0>;
		hw,lcdkit-delay-af-rst-off = <20>;
		hw,lcdkit-delay-af-blic-init = <0>;
		hw,lcdkit-bl-level-limit-percent = <100>;
		hw,lcdkit-use-second-ic-for-esd = <0>;
		hw,lcdkit-esd-check-num = <3>;
		hw,lcdkit-tp-reset-gpio = <64>;
		hw,lcdkit-h-back-porch = <40>;
		hw,lcdkit-h-front-porch = <120>;
		hw,lcdkit-h-pulse-width = <28>;
		hw,lcdkit-v-back-porch = <5>;
		hw,lcdkit-v-pulse-width = <5>;
		hw,lcdkit-v-front-porch = <40>;
		hw,lcdkit-h-sync-skew = <0>;
		hw,lcdkit-lcd-type = <2>;
		hw,lcdkit-panel-pt-test-support = <1>;
		hw,lcdkit-bias-power-ctrl-mode = <0x01>;
		hw,lcdkit-bl-dcs-level-trans-mode = <0>;
		hw,lcdkit-bl-dcs-reg              = <0x51>;
		hw,lcdkit-iovcc-power-ctrl-mode = <0x01>;
		hw,lcdkit-vci-power-ctrl-mode = <0x01>;
		hw,lcdkit-id0-gpio = <89>;
		hw,lcdkit-id1-gpio = <66>;
		hw,lcdkit-reset-gpio = <61>;
		hw,lcdkit-te-gpio = <0>;
		hw,lcdkit-vsp-gpio = <0>;
		hw,lcdkit-vsn-gpio = <0>;
		hw,lcdkit-iovcc-gpio = <0>;
		hw,lcdkit-vci-gpio = <0>;
		hw,lcdkit-bl-gpio = <0>;
		hw,lcdkit-iovcc-on-is-need-reset = <0>;
		hw,lcdkit-vsn-on-is-need-reset = <0>;
		hw,lcdkit-lcd-vsp = <5500000>;
		hw,lcdkit-lcd-vsn = <5500000>;
		hw,lcdkit-lcd-rst-first-high = <2>;
		hw,lcdkit-lcd-rst-low = <2>;
		hw,lcdkit-lcd-rst-second-high = <50>;
		hw,lcdkit-delay-af-vci-on = <0>;
		hw,lcdkit-delay-af-iovcc-on = <5>;
		hw,lcdkit-delay-af-bias-on = <0>;
		hw,lcdkit-delay-af-vsp-on = <2>;
		hw,lcdkit-delay-af-vsn-on = <3>;
		hw,lcdkit-delay-af-lp11 = <0>;
		hw,lcdkit-delay-af-tp-reset = <0>;
		hw,lcdkit-delay-af-vsn-off = <1>;
		hw,lcdkit-delay-af-vsp-off = <5>;
		hw,lcdkit-delay-af-bias-off = <0>;
		hw,lcdkit-delay-af-iovcc-off = <0>;
		hw,lcdkit-delay-af-vci-off = <0>;
		hw,lcdkit-panel-off-reset-high = <0>;
		hw,lcdkit-pan-dis-dimming-bf-sleep-in = <1>;
		hw,lcdkit-panel-disable-dimming-command = [15 01 00 00 00 00 02 53 04];
		hw,lcdkit-panel-disable-dimming-command-state = "dsi_lp_mode";
		hw,lcdkit-panel-enable-dimming-command = [15 01 00 00 00 00 02 53 2C];
		hw,lcdkit-panel-enable-dimming-command-state = "dsi_lp_mode";
    };
};
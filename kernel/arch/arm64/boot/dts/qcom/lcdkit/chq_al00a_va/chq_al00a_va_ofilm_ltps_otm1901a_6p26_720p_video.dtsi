/* Copyright (c) 2013, The Linux Foundation. All rights reserved.
 *
 * This program is free software; you can redistribute it and/or modify
 * it under the terms of the GNU General Public License version 2 and
 * only version 2 as published by the Free Software Foundation.
 *
 * This program is distributed in the hope that it will be useful,
 * but WITHOUT ANY WARRANTY; without even the implied warranty of
 * MERCHANTABILITY or FITNESS FOR A PARTICULAR PURPOSE.  See the
 * GNU General Public License for more details.
 */

/*-------------------------------------------------------------------------
 * This file is autogenerated file using gcdb parser. Please do not edit it.
 * Update input XML file to add a new entry or update variable in this file
 * VERSION = 1.1
 *-----------------------------------------------------------------------*/
/ {
	dsi_chq_al00a_va_ofilm_ltps_otm1901a_6p26_720p_video: lcdkit_chq_al00a_va_ofilm_ltps_otm1901a_6p26_720p_video {
		compatible = "ofilm-ltps-otm1901a-6p26-720p-video";
		hw,lcdkit-panel-name = "OFILM-LTPS-OTM1901A 6P26 VIDEO TFT 720 x 1520";
		hw,lcdkit-panel-type = <0x01>;
		hw,lcdkit-panel-xres = <720>;
		hw,lcdkit-panel-yres = <1520>;
		hw,lcdkit-panel-width = <68>;
		hw,lcdkit-panel-height = <144>;
		hw,lcdkit-panel-on-command = [39 01 00 00 00 00 02 00 00
				39 01 00 00 00 00 05 FF 19 01 01 00
				39 01 00 00 00 00 02 00 80
				39 01 00 00 00 00 03 FF 19 01
				39 01 00 00 00 00 02 00 90
				39 01 00 00 00 00 02 B3 70
				39 01 00 00 00 00 02 00 92
				39 01 00 00 00 00 02 B3 80
				39 01 00 00 00 00 02 00 A1
				39 01 00 00 00 00 05 B3 02 D0 05 F0
				39 01 00 00 00 00 02 00 A6
				39 01 00 00 00 00 02 B3 20
				39 01 00 00 00 00 02 00 DA
				39 01 00 00 00 00 02 F5 21
				39 01 00 00 00 00 02 00 00
				39 01 00 00 00 00 02 FB 01
				39 01 00 00 00 00 02 00 00
				39 01 00 00 00 00 02 EB 10
				39 01 00 00 00 00 02 00 02
				39 01 00 00 00 00 02 FF 03
				39 01 00 00 00 00 02 00 00
				39 01 00 00 00 00 02 C0 00
				39 01 00 00 00 00 02 00 02
				39 01 00 00 00 00 02 FF 01
				39 01 00 00 00 00 02 00 00
				39 01 00 00 00 00 02 1C 33
				39 01 00 00 00 00 02 00 A0
				39 01 00 00 00 00 02 C1 E8
				39 01 00 00 00 00 02 00 A7
				39 01 00 00 00 00 02 C1 00
				39 01 00 00 00 00 02 00 90
				39 01 00 00 00 00 07 C0 00 2F 00 00 00 01
				39 01 00 00 00 00 02 00 C0
				39 01 00 00 00 00 07 C0 00 2F 00 00 00 01
				39 01 00 00 00 00 02 00 9A
				39 01 00 00 00 00 02 C0 1E
				39 01 00 00 00 00 02 00 AC
				39 01 00 00 00 00 02 C0 06
				39 01 00 00 00 00 02 00 DC
				39 01 00 00 00 00 02 C0 06
				39 01 00 00 00 00 02 00 81
				39 01 00 00 00 00 02 A5 04
				39 01 00 00 00 00 02 00 D0
				39 01 00 00 00 00 05 F5 00 00 00 00
				39 01 00 00 00 00 02 00 92
				39 01 00 00 00 00 02 E9 00
				39 01 00 00 00 00 02 00 93
				39 01 00 00 00 00 02 C5 19
				39 01 00 00 00 00 02 00 97
				39 01 00 00 00 00 02 C5 14
				39 01 00 00 00 00 02 00 95
				39 01 00 00 00 00 02 C5 2D
				39 01 00 00 00 00 02 00 99
				39 01 00 00 00 00 02 C5 28
				39 01 00 00 00 00 02 00 80
				39 01 00 00 00 00 0f C0 00 AC 00 08 08 00 AC 08 08 00 AC 00 08 08
				39 01 00 00 00 00 02 00 f0
				39 01 00 00 00 00 07 C3 11 01 00 00 00 0C
				39 01 00 00 00 00 02 00 A0
				39 01 00 00 00 00 08 C0 00 00 00 00 00 1C 0A
				39 01 00 00 00 00 02 00 D0
				39 01 00 00 00 00 08 C0 00 00 00 00 00 1C 0A
				39 01 00 00 00 00 02 00 90
				39 01 00 00 00 00 09 C2 81 00 04 88 81 00 04 88
				39 01 00 00 00 00 02 00 80
				39 01 00 00 00 00 0d C3 00 01 03 00 04 88 01 02 03 00 04 88
				39 01 00 00 00 00 02 00 90
				39 01 00 00 00 00 0d C3 02 03 03 00 04 88 03 04 03 00 04 88
				39 01 00 00 00 00 02 00 A0
				39 01 00 00 00 00 0d C3 00 01 03 00 04 88 01 02 03 00 04 88
				39 01 00 00 00 00 02 00 B0
				39 01 00 00 00 00 0d C3 02 03 03 00 04 88 03 04 03 00 04 88
				39 01 00 00 00 00 02 00 80
				39 01 00 00 00 00 10 CC 09 0A 11 12 13 14 15 16 17 18 28 28 28 28 28
				39 01 00 00 00 00 02 00 90
				39 01 00 00 00 00 10 CC 0A 09 14 13 12 11 18 17 16 15 28 28 28 28 28
				39 01 00 00 00 00 02 00 A0
				39 01 00 00 00 00 10 CC 20 21 20 21 22 23 24 25 26 26 26 26 26 26 26
				39 01 00 00 00 00 02 00 B0
				39 01 00 00 00 00 09 CC 01 02 03 05 06 07 04 08
				39 01 00 00 00 00 02 00 C0
				39 01 00 00 00 00 0d CC 00 00 00 00 00 00 00 00 00 00 00 77
				39 01 00 00 00 00 02 00 D0
				39 01 00 00 00 00 0d CC F0 FF CF 00 00 00 00 00 33 03 00 77
				39 01 00 00 00 00 02 00 80
				39 01 00 00 00 00 10 CB 00 00 0F 0F 0F 0F 0F 0F 0F 0F FF 00 00 00 00
				39 01 00 00 00 00 02 00 90
				39 01 00 00 00 00 10 CB 00 00 00 00 00 00 00 00 00 00 00 00 00 00 00
				39 01 00 00 00 00 02 00 A0
				39 01 00 00 00 00 10 CB 05 05 F5 F5 F5 F5 F5 F5 F5 F5 0F F0 00 00 00
				39 01 00 00 00 00 02 00 B0
				39 01 00 00 00 00 10 CB 15 15 00 00 00 00 00 00 00 00 00 00 00 00 00
				39 01 00 00 00 00 02 00 C0
				39 01 00 00 00 00 09 CB 00 00 00 00 00 00 77 77
				39 01 00 00 00 00 02 00 D0
				39 01 00 00 00 00 09 CB 00 00 00 00 00 00 77 77
				39 01 00 00 00 00 02 00 E0
				39 01 00 00 00 00 09 CB 33 33 33 00 00 00 77 77
				39 01 00 00 00 00 02 00 F0
				39 01 00 00 00 00 09 CB 11 11 11 00 00 00 77 77
				39 01 00 00 00 00 02 00 80
				39 01 00 00 00 00 10 CD 3F 3F 3F 3F 3F 3F 3F 3F 0D 21 20 1F 0C 0B 0A
				39 01 00 00 00 00 02 00 90
				39 01 00 00 00 00 0c CD 09 08 07 02 25 25 25 25 25 25 25
				39 01 00 00 00 00 02 00 A0
				39 01 00 00 00 00 10 CD 3F 3F 3F 3F 3F 3F 3F 3F 0D 21 20 1F 0C 0B 06
				39 01 00 00 00 00 02 00 B0
				39 01 00 00 00 00 0c CD 05 04  03 01 25 25 25 25 25 25 25
				39 01 00 00 00 00 02 00 89
				39 01 00 00 00 00 02 F3 5A
				39 01 00 00 00 00 02 00 90
				39 01 00 00 00 00 02 F3 01
				39 01 00 00 00 00 02 00 82
				39 01 00 00 00 00 02 A5 1F
				39 01 00 00 00 00 02 00 C2
				39 01 00 00 00 00 02 C5 1C
				39 01 00 00 00 00 02 00 DC
				39 01 00 00 00 00 02 C0 04
				39 01 00 00 00 00 02 00 AC
				39 01 00 00 00 00 02 C0 04
				39 01 00 00 00 00 02 00 C1
				39 01 00 00 00 00 02 C5 77
				39 01 00 00 00 00 02 00 CD
				39 01 00 00 00 00 02 f5 19
				39 01 00 00 00 00 02 00 DB
				39 01 00 00 00 00 02 f5 19
				39 01 00 00 00 00 02 00 F5
				39 01 00 00 00 00 02 C1 40
				39 01 00 00 00 00 02 00 B9
				39 01 00 00 00 00 02 C0 11
				39 01 00 00 00 00 02 00 8D
				39 01 00 00 00 00 02 F5 20
				39 01 00 00 00 00 02 00 F7
				39 01 00 00 00 00 05 C3 02 10 00 00
				39 01 00 00 00 00 02 00 80
				39 01 00 00 00 00 02 C4 18
				39 01 00 00 00 00 02 00 83
				39 01 00 00 00 00 02 C4 00
				39 01 00 00 00 00 02 00 84
				39 01 00 00 00 00 02 C4 22
				39 01 00 00 00 00 02 00 A0
				39 01 00 00 00 00 09 c2 86 01 03 8c 00 00 00 00
				39 01 00 00 00 00 02 00 00
				39 01 00 00 00 00 03 D8 2B 2B
				39 01 00 00 00 00 02 00 B3
				39 01 00 00 00 00 02 C0 00
				39 01 00 00 00 00 02 00 BC
				39 01 00 00 00 00 02 C0 CC
				39 01 00 00 00 00 02 00 00
				39 01 00 00 00 00 02 00 B0
				39 01 00 00 00 00 02 CA 04
				39 01 00 00 00 00 02 00 B3
				39 01 00 00 00 00 02 CA 48
				39 01 00 00 00 00 19 E1 04 11 1A 29 34 3C 4A 5E 68 7A 82 88 73 6F 6C 5D 4A 39 2E 27 1D 14 0C 08
				39 01 00 00 00 00 02 00 00
				39 01 00 00 00 00 19 E2 04 11 1A 29 34 3C 4A 5E 68 7A 82 88 73 6F 6C 5D 4A 39 2E 27 1D 14 0C 08
				39 01 00 00 00 00 02 00 00
				39 01 00 00 00 00 19 E3 04 11 1A 29 34 3C 4A 5E 68 7A 82 88 73 6F 6C 5D 4A 39 2E 27 1D 14 0C 08
				39 01 00 00 00 00 02 00 00
				39 01 00 00 00 00 19 E4 04 11 1A 29 34 3C 4A 5E 68 7A 82 88 73 6F 6C 5D 4A 39 2E 27 1D 14 0C 08
				39 01 00 00 00 00 02 00 00
				39 01 00 00 00 00 19 E5 04 11 1A 29 34 3C 4A 5E 68 7A 82 88 73 6F 6C 5D 4A 39 2E 27 1D 14 0C 08
				39 01 00 00 00 00 02 00 00
				39 01 00 00 00 00 19 E6 04 11 1A 29 34 3C 4A 5E 68 7A 82 88 73 6F 6C 5D 4A 39 2E 27 1D 14 0C 08
				39 01 00 00 00 00 02 00 00
				39 01 00 00 00 00 04 FF FF FF FF
				39 01 00 00 00 00 03 51 00 00
				39 01 00 00 00 00 02 53 2C
				39 01 00 00 00 00 02 55 00
				39 01 00 00 64 00 02 11 00
				39 01 00 00 00 00 02 29 00];
		hw,lcdkit-panel-on-command-state = "dsi_lp_mode";
		hw,lcdkit-panel-display-on-command = [05 01 00 00 64 00 02 11 00
                    05 01 00 00 14 00 02 29 00];
		hw,lcdkit-panel-off-command = [05 01 00 00 14 00 02 28 00
					05 01 00 00 64 00 02 10 00];
		hw,lcdkit-panel-off-command-state = "dsi_lp_mode";
		hw,lcdkit-panel-backlight-command = [39 01 00 00 00 00 03 51 00 00];
		hw,lcdkit-panel-backlight-command-state = "dsi_lp_mode";
		hw,lcdkit-panel-cabc-off-command = [15 01 00 00 0a 00 02 55 00];
		hw,lcdkit-panel-cabc-off-command-state = "dsi_lp_mode";
		hw,lcdkit-panel-cabc-ui-command = [15 01 00 00 0a 00 02 55 01
				  15 01 00 00 0a 00 02 53 2C];
		hw,lcdkit-panel-cabc-ui-command-state = "dsi_lp_mode";
		hw,lcdkit-panel-cabc-still-command = [15 01 00 00 0a 00 02 55 02
				     15 01 00 00 0a 00 02 53 2C];
		hw,lcdkit-panel-cabc-still-command-state = "dsi_lp_mode";
		hw,lcdkit-panel-cabc-moving-command = [15 01 00 00 0a 00 02 55 03
				      15 01 00 00 0a 00 02 53 2C];
		hw,lcdkit-panel-cabc-moving-command-state = "dsi_lp_mode";
		hw,lcdkit-panel-cabc-support = <0>;
		hw,lcdkit-panel-dot-inversion-command = [39 01 00 00 00 00 02 00 00
				39 01 00 00 00 00 05 FF 19 01 01 00
				39 01 00 00 00 00 02 00 80
				39 01 00 00 00 00 03 FF 19 01
				39 01 00 00 00 00 02 00 B3
				39 01 00 00 00 00 02 C0 10
				39 01 00 00 00 00 02 00 00
				39 01 00 00 00 00 02 FB 01
                39 01 00 00 00 00 02 00 00
                39 01 00 00 00 00 04 FF FF FF FF];
		hw,lcdkit-panel-dot-inversion-command-state = "dsi_lp_mode";
		hw,lcdkit-panel-column-inversion-command = [39 01 00 00 00 00 02 00 00
				39 01 00 00 00 00 05 FF 19 01 01 00
				39 01 00 00 00 00 02 00 80
				39 01 00 00 00 00 03 FF 19 01
				39 01 00 00 00 00 02 00 B3
				39 01 00 00 00 00 02 C0 00
                39 01 00 00 00 00 02 00 00
                39 01 00 00 00 00 02 FB 01
                39 01 00 00 00 00 02 00 00
                39 01 00 00 00 00 04 FF FF FF FF];
		hw,lcdkit-panel-column-inversion-command-state = "dsi_lp_mode";
		hw,lcdkit-panel-inversion-support = <1>;
		hw,lcdkit-panel-forword-scan-command = [39 01 00 00 00 00 02 00 00
				39 01 00 00 00 00 05 FF 19 01 01 00
				39 01 00 00 00 00 02 00 80
				39 01 00 00 00 00 03 FF 19 01
				39 01 00 00 00 00 02 00 B4
				39 01 00 00 00 00 02 C0 80
                39 01 00 00 00 00 02 00 00
                39 01 00 00 00 00 02 FB 01
                39 01 00 00 00 00 02 00 00
                39 01 00 00 00 00 04 FF FF FF FF];
		hw,lcdkit-panel-forword-scan-command-state = "dsi_lp_mode";
		hw,lcdkit-panel-revert-scan-command = [39 01 00 00 00 00 02 00 00
				39 01 00 00 00 00 05 FF 19 01 01 00
				39 01 00 00 00 00 02 00 80
				39 01 00 00 00 00 03 FF 19 01
				39 01 00 00 00 00 02 00 B4
				39 01 00 00 00 00 02 C0 C0
                39 01 00 00 00 00 02 00 00
                39 01 00 00 00 00 02 FB 01
                39 01 00 00 00 00 02 00 00
                39 01 00 00 00 00 04 FF FF FF FF];
		hw,lcdkit-panel-revert-scan-command-state = "dsi_lp_mode";
		hw,lcdkit-panel-scan-support = <1>;
		hw,lcdkit-panel-tp-lcd-reset-sync-support = <0>;
		hw,lcdkit-panel-display-region-support = <0>;
		hw,lcdkit-panel-checksum-support = <0>;
		hw,lcdkit-panel-esd-reg-command = [14 01 00 00 0a 00 01 0a];
		hw,lcdkit-panel-esd-reg-command-state = "dsi_lp_mode";
		hw,lcdkit-panel-esd-value = [9c];
		hw,lcdkit-panel-esd-support = <0>;
		hw,lcdkit-panel-check-reg-command = [14 01 00 00 0a 00 01 0a];
		hw,lcdkit-panel-check-reg-value = [9c];
		hw,lcdkit-panel-check-reg-command-state = "dsi_lp_mode";
		hw,lcdkit-panel-check-reg-support = <1>;
		hw,lcdkit-panel-bl-maxnit-command = [14 01 00 00 00 00 01 da];
		hw,lcdkit-panel-bl-maxnit-command-state = "dsi_lp_mode";
		hw,lcdkit-panel-bl-befreadconfig = [39 01 00 00 00 00 02 00 00
			39 01 00 00 00 00 04 FF 19 01 01
			39 01 00 00 00 00 02 00 00
			39 01 00 00 00 00 03 FF 19 01];
		hw,lcdkit-panel-bl-befreadconfig-state = "dsi_lp_mode";
		hw,lcdkit-panel-mipi-detect-support = <0>;
		hw,lcdkit-panel-shutdown-sleep-support = <0>;
		hw,lcdkit-dsi-bpp = <24>;
		hw,lcdkit-panel-cmd-type = <0>;
		hw,lcdkit-pixel-packing = <0>;
		hw,lcdkit-underflow-color = <0x00>;
		hw,lcdkit-border-color = <0>;
		hw,lcdkit-panel-orientation = <0>;
		hw,lcdkit-brightness-max-level = <255>;
		hw,lcdkit-bl-min-level = <12>;
		hw,lcdkit-bl-max-level = <255>;
		hw,lcdkit-interleave-mode = <0>;
		hw,lcdkit-te-using-te-pin;
		hw,lcdkit-h-sync-pulse = <1>;
		hw,lcdkit-bllp-power-mode;
		hw,lcdkit-bllp-eof-power-mode;
		hw,lcdkit-traffic-mode = "burst_mode";
		hw,lcdkit-te-dcs-command = <1>;
		hw,lcdkit-te-pin-select = <1>;
		hw,lcdkit-virtual-channel-id = <0>;
		hw,lcdkit-color-order = "rgb_swap_rgb";
		hw,lcdkit-lane-0-state;
		hw,lcdkit-lane-1-state;
		hw,lcdkit-lane-2-state;
		hw,lcdkit-h-left-border = <0>;
		hw,lcdkit-h-right-border = <0>;
		hw,lcdkit-v-top-border = <0>;
		hw,lcdkit-v-bottom-border = <0>;
		hw,lcdkit-panel-framerate = <60>;
		hw,lcdkit-panel-clockrate = <607890000>;
		hw,lcdkit-panel-timings = [20 1C 06 07 03 03 04 A0
			20 1C 06 07 03 03 04 A0
			20 1C 06 07 03 03 04 A0
			20 1C 06 07 03 03 04 A0
			20 13 05 06 03 03 04 A0];
		hw,lcdkit-panel-timings-phy-v2 = [20 1C 06 07 03 03 04 A0
			20 1C 06 07 03 03 04 A0
			20 1C 06 07 03 03 04 A0
			20 1C 06 07 03 03 04 A0
			20 13 05 06 03 03 04 A0];
		hw,lcdkit-t-clk-pre = <0x24>;
		hw,lcdkit-t-clk-post = <0x0B>;
		hw,lcdkit-tx-eot-append;
		hw,lcdkit-stream = <0>;
		hw,lcdkit-lp11-init;
		hw,lcdkit-mdp-trigger = "none";
		hw,lcdkit-dma-trigger = "trigger_sw";
		hw,lcdkit-bl-pmic-control-type = "bl_ctrl_dcs";
		qcom,panel-supply-entries = <&dsi_panel_pwr_supply>;
		hw,lcdkit-lane-map = "lane_map_0123";
		hw,lcdkit-delay-before-bl = <0>;
		hw,lcdkit-mipi-regulator-mode = <1>;
		hw,lcdkit-bl-en-gpio = <0>;
		hw,lcdkit-delay-af-rst-off = <20>;
		hw,lcdkit-delay-af-blic-init = <0>;
		hw,lcdkit-bl-level-limit-percent = <100>;
		hw,lcdkit-use-second-ic-for-esd = <0>;
		hw,lcdkit-esd-check-num = <3>;
		hw,lcdkit-tp-reset-gpio = <64>;
		hw,lcdkit-panel-bl-maxnit = <470>;
		hw,lcdkit-panel-getblmaxnit-type = <0>;
		hw,lcdkit-panel-getblmaxnit-offset = <400>;
		hw,lcdkit-h-back-porch = <46>;
		hw,lcdkit-h-front-porch = <46>;
		hw,lcdkit-h-pulse-width = <4>;
		hw,lcdkit-v-back-porch = <15>;
		hw,lcdkit-v-pulse-width = <1>;
		hw,lcdkit-v-front-porch = <16>;
		hw,lcdkit-h-sync-skew = <0>;
		hw,lcdkit-lcd-type = <0>;
		hw,lcdkit-panel-pt-test-support = <1>;
		hw,lcdkit-bias-power-ctrl-mode = <0x01>;
		hw,lcdkit-bl-dcs-level-trans-mode = <1>;
		hw,lcdkit-bl-dcs-reg              = <0x51>;
		hw,lcdkit-iovcc-power-ctrl-mode = <0x01>;
		hw,lcdkit-vci-power-ctrl-mode = <0x01>;
		hw,lcdkit-id0-gpio = <89>;
		hw,lcdkit-id1-gpio = <66>;
		hw,lcdkit-reset-gpio = <61>;
		hw,lcdkit-te-gpio = <0>;
		hw,lcdkit-vsp-gpio = <0>;
		hw,lcdkit-vsn-gpio = <0>;
		hw,lcdkit-iovcc-gpio = <0>;
		hw,lcdkit-vci-gpio = <0>;
		hw,lcdkit-bl-gpio = <0>;
		hw,lcdkit-iovcc-on-is-need-reset = <0>;
		hw,lcdkit-vsn-on-is-need-reset = <0>;
		hw,lcdkit-lcd-vsp = <5500000>;
		hw,lcdkit-lcd-vsn = <5500000>;
		hw,lcdkit-lcd-rst-first-high = <10>;
		hw,lcdkit-lcd-rst-low = <1>;
		hw,lcdkit-lcd-rst-second-high = <5>;
		hw,lcdkit-delay-af-vci-on = <0>;
		hw,lcdkit-delay-af-iovcc-on = <10>;
		hw,lcdkit-delay-af-bias-on = <0>;
		hw,lcdkit-delay-af-vsp-on = <1>;
		hw,lcdkit-delay-af-vsn-on = <3>;
		hw,lcdkit-delay-af-lp11 = <0>;
		hw,lcdkit-delay-af-tp-reset = <25>;
		hw,lcdkit-delay-af-vsn-off = <1>;
		hw,lcdkit-delay-af-vsp-off = <1>;
		hw,lcdkit-delay-af-bias-off = <0>;
		hw,lcdkit-delay-af-iovcc-off = <0>;
		hw,lcdkit-delay-af-vci-off = <0>;
		hw,lcdkit-panel-off-reset-high = <0>;
		hw,lcdkit-pan-dis-dimming-bf-sleep-in = <0>;
		hw,lcdkit-panel-disable-dimming-command = [15 01 00 00 00 00 02 53 04];
		hw,lcdkit-panel-disable-dimming-command-state = "dsi_lp_mode";
		hw,lcdkit-panel-enable-dimming-command = [15 01 00 00 00 00 02 53 2C];
		hw,lcdkit-panel-enable-dimming-command-state = "dsi_lp_mode";
    };
};
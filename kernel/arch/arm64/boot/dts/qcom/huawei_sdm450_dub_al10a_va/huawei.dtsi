#include "huawei-sensors.dtsi"
#include "huawei_dev_detect-va.dtsi"
#include "huawei-camera.dtsi"
#include "huawei-fac.dtsi"
#include "huawei-audio.dtsi"
#include "huawei-tp.dtsi"
#include "huawei-battery.dtsi"
#include "huawei-usb.dtsi"
#include "huawei-wifi.dtsi"
#include "huawei-bt.dtsi"
#include "huawei-fm.dtsi"
#include "huawei-gpio-led.dtsi"
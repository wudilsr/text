#include "huawei-sensors.dtsi"
#include "huawei-battery.dtsi"
#include "huawei-usb.dtsi"
#include "huawei-audio.dtsi"
#include "huawei-tp.dtsi"
#include "huawei-fac.dtsi"
#include "huawei-wifi.dtsi"
#include "huawei-bt.dtsi"
#include "huawei-fm.dtsi"
#include "huawei_dev_detect-va.dtsi"
#include "../huawei-sdm450-camera-chq-lx3.dtsi"
#include "huawei-antenna-boardid.dtsi"
#include "huawei-gpio-led.dtsi"

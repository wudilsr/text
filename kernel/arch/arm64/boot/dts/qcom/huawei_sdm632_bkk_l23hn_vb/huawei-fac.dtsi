/{
		huawei_fac_info {
		compatible = "huawei,hw_fac_info";
		fac,product_name = "BKK-L23";
		fac,hardware_ver = "HL1BKKM";
		fac,software_ver = "BKK_L23HN_VB";
		fac,simcard_adapt = "support";
		status = "ok";
	};
};

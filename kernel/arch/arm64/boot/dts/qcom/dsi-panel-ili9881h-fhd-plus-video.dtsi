/* Copyright (c) 2018, The Linux Foundation. All rights reserved.
 *
 * This program is free software; you can redistribute it and/or modify
 * it under the terms of the GNU General Public License version 2 and
 * only version 2 as published by the Free Software Foundation.
 *
 * This program is distributed in the hope that it will be useful,
 * but WITHOUT ANY WARRANTY; without even the implied warranty of
 * MERCHANTABILITY or FITNESS FOR A PARTICULAR PURPOSE.  See the
 * GNU General Public License for more details.
 */

&mdss_mdp {
	dsi_ili9881h_hlt_video: qcom,mdss_dsi_ili9881h_hlt_video{
		qcom,mdss-dsi-panel-name =
			"ili9881h 720p video mode dsi panel";
		qcom,mdss-dsi-panel-type = "dsi_video_mode";
		qcom,mdss-dsi-panel-framerate = <60>;
		qcom,mdss-dsi-virtual-channel-id = <0>;
		qcom,mdss-dsi-stream = <0>;
		qcom,mdss-dsi-panel-width = <720>;
		qcom,mdss-dsi-panel-height = <1440>;
		qcom,mdss-dsi-h-front-porch = <48>;
		qcom,mdss-dsi-h-back-porch = <48>;
		qcom,mdss-dsi-h-pulse-width = <4>;
		qcom,mdss-dsi-h-sync-skew = <0>;
		qcom,mdss-dsi-v-back-porch = <8>;
		qcom,mdss-dsi-v-front-porch = <160>;
		qcom,mdss-dsi-v-pulse-width = <4>;
		qcom,mdss-dsi-h-left-border = <0>;
		qcom,mdss-dsi-h-right-border = <0>;
		qcom,mdss-dsi-v-top-border = <0>;
		qcom,mdss-dsi-v-bottom-border = <0>;
		qcom,mdss-dsi-bpp = <24>;
		qcom,mdss-dsi-color-order = "rgb_swap_rgb";
		qcom,mdss-dsi-underflow-color = <0xff>;
		qcom,mdss-dsi-border-color = <0>;
		qcom,mdss-dsi-on-command = [
			39 01 00 00 00 00 04 FF 98 81 01
			39 01 00 00 00 00 02 09 01
			39 01 00 00 00 00 02 17 01
			39 01 00 00 00 00 02 b9 08
			39 01 00 00 00 00 02 c3 ff
			39 01 00 00 00 00 04 FF 98 81 05
			39 01 00 00 00 00 02 03 01
			39 01 00 00 00 00 02 04 10
			39 01 00 00 00 00 02 63 7E
			39 01 00 00 00 00 02 64 7E
			39 01 00 00 00 00 02 68 A1
			39 01 00 00 00 00 02 69 B1
			39 01 00 00 00 00 02 6A 79
			39 01 00 00 00 00 02 6B 89
			39 01 00 00 00 00 02 32 00
			39 01 00 00 00 00 02 33 00
			39 01 00 00 00 00 02 36 00
			39 01 00 00 00 00 02 37 01
			39 01 00 00 00 00 02 34 01
			39 01 00 00 00 00 02 35 08
			39 01 00 00 00 00 02 38 01
			39 01 00 00 00 00 02 39 01
			39 01 00 00 00 00 04 FF 98 81 06
			39 01 00 00 00 00 02 C2 04
			39 01 00 00 00 00 04 FF 98 81 02
			39 01 00 00 00 00 02 4D 4E
			39 01 00 00 00 00 02 4E 00
			39 01 00 00 00 00 04 FF 98 81 06
			39 01 00 00 00 00 02 D6 85
			39 01 00 00 00 00 04 FF 98 81 0E
			39 01 00 00 00 00 02 00 A0
			39 01 00 00 00 00 02 01 26
			39 01 00 00 00 00 02 13 0d
			39 01 00 00 00 00 02 20 0B
			39 01 00 00 00 00 02 29 78
			39 01 00 00 00 00 02 25 06
			39 01 00 00 00 00 02 26 29
			39 01 00 00 00 00 02 2D A1
			39 01 00 00 00 00 02 40 0B
			39 01 00 00 00 00 02 49 78
			39 01 00 00 00 00 02 45 06
			39 01 00 00 00 00 02 46 29
			39 01 00 00 00 00 02 4D A1
			39 01 00 00 00 00 02 C1 50
			39 01 00 00 00 00 02 D0 04
			39 01 00 00 00 00 02 D6 20
			39 01 00 00 00 00 02 D7 30
			39 01 00 00 00 00 02 D8 A0
			39 01 00 00 00 00 02 D9 A0
			39 01 00 00 64 00 02 E2 19
			39 01 00 00 00 00 04 FF 98 81 00
			39 01 00 00 64 00 02 11 00
			39 01 00 00 64 00 02 29 00
			39 01 00 00 64 00 02 35 00
			39 01 00 00 00 00 02 53 24
			39 01 00 00 00 00 02 55 01
			39 01 00 00 00 00 03 51 ff ff];
		qcom,mdss-dsi-off-command = [
			05 01 00 00 32 00 02 28 00
			05 01 00 00 96 00 02 10 00];
		qcom,mdss-dsi-on-command-state = "dsi_lp_mode";
		qcom,mdss-dsi-off-command-state = "dsi_hs_mode";
//		qcom,mdss-dsi-h-sync-pulse = <0>;
		qcom,mdss-dsi-traffic-mode = "non_burst_sync_event";
		qcom,mdss-dsi-lane-map = "lane_map_0123";
		qcom,mdss-dsi-bllp-eof-power-mode;
		qcom,mdss-dsi-bllp-power-mode;
		qcom,mdss-dsi-tx-eot-append;
		qcom,mdss-dsi-lane-0-state;
		qcom,mdss-dsi-lane-1-state;
		qcom,mdss-dsi-lane-2-state;
		qcom,mdss-dsi-lane-3-state;
		qcom,mdss-dsi-t-clk-post = <0x0a>;
		qcom,mdss-dsi-t-clk-pre = <0x1f>;
		qcom,mdss-dsi-dma-trigger = "trigger_sw";
		qcom,mdss-dsi-mdp-trigger = "none";
		qcom,mdss-dsi-lp11-init;
		qcom,mdss-dsi-reset-sequence = <1 10>, <0 10>, <1 10>;
	};
};

/* Copyright (c) 2014-2015, The Linux Foundation. All rights reserved.
 *
 * This program is free software; you can redistribute it and/or modify
 * it under the terms of the GNU General Public License version 2 and
 * only version 2 as published by the Free Software Foundation.
 *
 * This program is distributed in the hope that it will be useful,
 * but WITHOUT ANY WARRANTY; without even the implied warranty of
 * MERCHANTABILITY or FITNESS FOR A PARTICULAR PURPOSE.  See the
 * GNU General Public License for more details.
 */
/{
	hw_antenna_adc: hw_antenna_adc {
	compatible="huawei-vadc";
	vadc-name="antenna";
	qcom,antenna-vadc=<&pmi632_vadc>; //adc
	channel = <0x14>; //channel
	status="okay";
    };

};

&soc {
	antenna_board_detect {
		compatible = "huawei,antenna_board_detect";
		is-adc-mode;
		qcom,antenna_adc-vadc = <&hw_antenna_adc>;
		switch-mode = <0>;
		antenna_board_match_range = <820 975>;
	};
};
